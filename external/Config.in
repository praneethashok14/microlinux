## external/package/kde-elisa/Config.in
```kconfig
config BR2_PACKAGE_KDE_ELISA
	bool "kde-elisa"
	select BR2_PACKAGE_KDE_KIRIGAMI_ADDONS
	select BR2_PACKAGE_KF6_EXTRA_CMAKE_MODULES
	select BR2_PACKAGE_KF6_KCODECS
	select BR2_PACKAGE_KF6_KCOLORSCHEME
	select BR2_PACKAGE_KF6_KCONFIG
	select BR2_PACKAGE_KF6_KCONFIGWIDGETS
	select BR2_PACKAGE_KF6_KCOREADDONS
	select BR2_PACKAGE_KF6_KDBUSADDONS
	select BR2_PACKAGE_KF6_KFILEMETADATA
	select BR2_PACKAGE_KF6_KI18N
	select BR2_PACKAGE_KF6_KICONTHEMES
	select BR2_PACKAGE_KF6_KIO
	select BR2_PACKAGE_KF6_KIRIGAMI
	select BR2_PACKAGE_KF6_KXMLGUI
	select BR2_PACKAGE_KF6_QQC2_DESKTOP_STYLE
	select BR2_PACKAGE_QT6BASE
	select BR2_PACKAGE_QT6DECLARATIVE
	select BR2_PACKAGE_QT6MULTIMEDIA
	select BR2_PACKAGE_QT6SVG
	help
	  KDE gear: elisa 26.08.3. GENERATED by scripts/kde-gen.py.
```

## external/package/kde-elogind/Config.in
```kconfig
config BR2_PACKAGE_KDE_ELOGIND
	bool "kde-elogind"
	select BR2_PACKAGE_LIBCAP
	select BR2_PACKAGE_DBUS
	select BR2_PACKAGE_LINUX_PAM
	select BR2_PACKAGE_UTIL_LINUX
	select BR2_PACKAGE_UTIL_LINUX_LIBMOUNT
	help
	  elogind 257: logind (seats, sessions, power keys) without
	  systemd, for KWin, polkit, SDDM and Plasma on BusyBox init.
```

## external/package/kde-ffmpegthumbs/Config.in
```kconfig
config BR2_PACKAGE_KDE_FFMPEGTHUMBS
	bool "kde-ffmpegthumbs"
	select BR2_PACKAGE_FFMPEG
	select BR2_PACKAGE_KF6_EXTRA_CMAKE_MODULES
	select BR2_PACKAGE_KF6_KCONFIG
	select BR2_PACKAGE_KF6_KIO
	select BR2_PACKAGE_QT6BASE
	help
	  KDE gear: ffmpegthumbs 26.08.3. GENERATED by scripts/kde-gen.py.
```
