## external/Config.in
```kconfig
menu "MicroLinux packages"
source "$BR2_EXTERNAL_MICROLINUX_PATH/package/kf6-extra-cmake-modules/Config.in"
source "$BR2_EXTERNAL_MICROLINUX_PATH/package/kf6-kwindowsystem/Config.in"
source "$BR2_EXTERNAL_MICROLINUX_PATH/package/kf6-kidletime/Config.in"
source "$BR2_EXTERNAL_MICROLINUX_PATH/package/kf6-solid/Config.in"
source "$BR2_EXTERNAL_MICROLINUX_PATH/package/layer-shell-qt/Config.in"
source "$BR2_EXTERNAL_MICROLINUX_PATH/package/polkit-qt6/Config.in"
source "$BR2_EXTERNAL_MICROLINUX_PATH/package/muparser/Config.in"
source "$BR2_EXTERNAL_MICROLINUX_PATH/package/xdg-user-dirs/Config.in"
source "$BR2_EXTERNAL_MICROLINUX_PATH/package/libxklavier/Config.in"
source "$BR2_EXTERNAL_MICROLINUX_PATH/package/lightdm/Config.in"
source "$BR2_EXTERNAL_MICROLINUX_PATH/package/lightdm-gtk-greeter/Config.in"
source "$BR2_EXTERNAL_MICROLINUX_PATH/package/lxqt-build-tools/Config.in"
source "$BR2_EXTERNAL_MICROLINUX_PATH/package/libdbusmenu-lxqt/Config.in"
source "$BR2_EXTERNAL_MICROLINUX_PATH/package/libqtxdg/Config.in"
source "$BR2_EXTERNAL_MICROLINUX_PATH/package/lxqt-menu-data/Config.in"
source "$BR2_EXTERNAL_MICROLINUX_PATH/package/liblxqt/Config.in"
source "$BR2_EXTERNAL_MICROLINUX_PATH/package/libsysstat/Config.in"
source "$BR2_EXTERNAL_MICROLINUX_PATH/package/qtxdg-tools/Config.in"
source "$BR2_EXTERNAL_MICROLINUX_PATH/package/libfm-qt/Config.in"
source "$BR2_EXTERNAL_MICROLINUX_PATH/package/lxqt-globalkeys/Config.in"
source "$BR2_EXTERNAL_MICROLINUX_PATH/package/lxqt-qtplugin/Config.in"
source "$BR2_EXTERNAL_MICROLINUX_PATH/package/lxqt-session/Config.in"
source "$BR2_EXTERNAL_MICROLINUX_PATH/package/qtermwidget/Config.in"
source "$BR2_EXTERNAL_MICROLINUX_PATH/package/lxqt-panel/Config.in"
source "$BR2_EXTERNAL_MICROLINUX_PATH/package/pcmanfm-qt/Config.in"
source "$BR2_EXTERNAL_MICROLINUX_PATH/package/qterminal/Config.in"
source "$BR2_EXTERNAL_MICROLINUX_PATH/package/lxqt-powermanagement/Config.in"
source "$BR2_EXTERNAL_MICROLINUX_PATH/package/lxqt-runner/Config.in"
source "$BR2_EXTERNAL_MICROLINUX_PATH/package/lxqt-themes/Config.in"
source "$BR2_EXTERNAL_MICROLINUX_PATH/package/lxqt-notificationd/Config.in"
source "$BR2_EXTERNAL_MICROLINUX_PATH/package/lxqt-about/Config.in"
source "$BR2_EXTERNAL_MICROLINUX_PATH/package/lxqt-archiver/Config.in"
source "$BR2_EXTERNAL_MICROLINUX_PATH/package/lxqt-config/Config.in"
source "$BR2_EXTERNAL_MICROLINUX_PATH/package/libxcrypt-compat/Config.in"
source "$BR2_EXTERNAL_MICROLINUX_PATH/package/ncurses5-compat/Config.in"
source "$BR2_EXTERNAL_MICROLINUX_PATH/package/firefox-bin/Config.in"
source "$BR2_EXTERNAL_MICROLINUX_PATH/package/el7-runtime/Config.in"
source "$BR2_EXTERNAL_MICROLINUX_PATH/package/el10-runtime/Config.in"
source "$BR2_EXTERNAL_MICROLINUX_PATH/package/debian-runtime/Config.in"
source "$BR2_EXTERNAL_MICROLINUX_PATH/package/kde-elogind/Config.in"
source "$BR2_EXTERNAL_MICROLINUX_PATH/package/kde-sddm/Config.in"
source "$BR2_EXTERNAL_MICROLINUX_PATH/package/kde-accountsservice/Config.in"
source "$BR2_EXTERNAL_MICROLINUX_PATH/package/kde-qcoro/Config.in"
source "$BR2_EXTERNAL_MICROLINUX_PATH/package/kde-appstream/Config.in"
source "$BR2_EXTERNAL_MICROLINUX_PATH/package/qt5-base/Config.in"
source "$BR2_EXTERNAL_MICROLINUX_PATH/kde/Config.in"
endmenu
source "$BR2_EXTERNAL_MICROLINUX_PATH/package/ml-settings/Config.in"
source "$BR2_EXTERNAL_MICROLINUX_PATH/package/ml-installer/Config.in"
source "$BR2_EXTERNAL_MICROLINUX_PATH/package/shim-signed-bin/Config.in"
source "$BR2_EXTERNAL_MICROLINUX_PATH/package/ml-software/Config.in"
source "$BR2_EXTERNAL_MICROLINUX_PATH/package/chromium-bin/Config.in"
source "$BR2_EXTERNAL_MICROLINUX_PATH/package/firmware-amdgpu/Config.in"
source "$BR2_EXTERNAL_MICROLINUX_PATH/package/firmware-nvidia/Config.in"
source "$BR2_EXTERNAL_MICROLINUX_PATH/package/temurin-jre-bin/Config.in"
source "$BR2_EXTERNAL_MICROLINUX_PATH/package/prismlauncher-bin/Config.in"
```

## external/package/chromium-bin/Config.in
```kconfig
config BR2_PACKAGE_CHROMIUM_BIN
	bool "chromium-bin (ungoogled-chromium, for the package repository)"
	depends on BR2_aarch64 || BR2_x86_64
	depends on BR2_TOOLCHAIN_USES_GLIBC
	depends on BR2_PACKAGE_LIBGTK3_X11
	depends on BR2_PACKAGE_LIBNSPR_ARCH_SUPPORT
	select BR2_PACKAGE_LIBNSS
	select BR2_PACKAGE_CUPS # libcups.so.2
	help
	  The portable Linux build of ungoogled-chromium (Chromium without
	  Google services). It is not put on the ISO: it is published in the
	  package repository as the image package "chromium" (mounted at
	  /opt/chromium); NSS/NSPR and libcups become repository packages
	  it depends on.

	  https://github.com/ungoogled-software/ungoogled-chromium-portablelinux
```

## external/package/debian-runtime/Config.in
```kconfig
config BR2_PACKAGE_DEBIAN_RUNTIME
	bool "debian-runtime (Debian 13 userspace, as mlpkg module)"
	depends on BR2_aarch64 || BR2_x86_64
	help
	  Debian 13 "trixie" (glibc 2.41) runtime built from the official
	  Debian packages pinned in debian-<arch>.lock (from
	  snapshot.debian.org, so the URLs never change). It is packaged as
	  the mlpkg module debian-runtime, mounted at /opt/debian, and used
	  by deb-run / deb-chroot for Debian and Ubuntu binaries that need
	  Debian's libraries, and to install .deb packages (dpkg, with a
	  dpkg database of the runtime's own packages).

	  Requires dpkg-deb on the build host.
```

## external/package/el10-runtime/Config.in
```kconfig
config BR2_PACKAGE_EL10_RUNTIME
	bool "el10-runtime (AlmaLinux 10 userspace, as mlpkg module)"
	depends on BR2_aarch64 || BR2_x86_64
	help
	  RHEL 10 compatible (glibc 2.39) runtime built from the official
	  AlmaLinux 10.2 RPMs pinned in el10-<arch>.lock (x86_64: the
	  x86_64_v2 rebuild, which also runs on CPUs without AVX2). It is
	  packaged as the mlpkg module el10-runtime, mounted at /opt/el10,
	  and used by el10-run / el10-chroot for binaries that need EL10
	  libraries (libcrypt.so.2, libtinfo.so.6, libpcre2-8.so.0, ...)
	  and to install EL10 RPMs (rpm, with an rpm database of the
	  runtime's own packages).

	  Requires rpm2cpio and cpio on the build host, and rpm for the
	  rpm database.
```

## external/package/el7-runtime/Config.in
```kconfig
config BR2_PACKAGE_EL7_RUNTIME
	bool "el7-runtime (CentOS 7 userspace, as mlpkg module)"
	depends on BR2_aarch64 || BR2_x86_64
	help
	  Exact RHEL/CentOS 7 (glibc 2.17) runtime built from the official
	  CentOS 7.9.2009 RPMs pinned in el7-<arch>.lock (AltArch tree
	  for aarch64, main tree for x86_64). It is
	  packaged as the mlpkg module el7-runtime, mounted at /opt/el7, and
	  used by el7-run / el7-chroot for binaries that need EL7-only
	  libraries (libssl.so.10, libreadline.so.6, ...).

	  Requires rpm2cpio and cpio on the build host.
```

## external/package/firefox-bin/Config.in
```kconfig
config BR2_PACKAGE_FIREFOX_BIN
	bool "firefox-bin (official Mozilla build, as mlpkg module)"
	depends on BR2_aarch64 || BR2_x86_64
	depends on BR2_TOOLCHAIN_USES_GLIBC
	depends on BR2_PACKAGE_LIBGTK3_X11
	select BR2_PACKAGE_DBUS
	select BR2_PACKAGE_XLIB_LIBXCOMPOSITE
	select BR2_PACKAGE_XLIB_LIBXDAMAGE
	select BR2_PACKAGE_XLIB_LIBXRANDR
	select BR2_PACKAGE_XLIB_LIBXTST
	select BR2_PACKAGE_ALSA_LIB
	help
	  Unmodified Firefox ESR binary release from Mozilla for Linux
	  aarch64 or x86_64. It is not installed into the root filesystem; it is
	  packaged as an mlpkg module (packages/firefox-*.mlp) that is
	  mounted at /opt/firefox. Mozilla permits redistribution of
	  unmodified official binaries; see docs/LICENSES.md.
```

## external/package/firmware-amdgpu/Config.in
```kconfig
config BR2_PACKAGE_FIRMWARE_AMDGPU
	bool "firmware-amdgpu (for the package repository)"
	depends on BR2_x86_64
	help
	  AMD Radeon GPU firmware (amdgpu and older radeon cards); reboot after installing.

	  In the package repository, not on the ISO: the kernel only
	  loads amdgpu/radeon once this is installed
	  (/etc/modprobe.d/gpu.conf).
```

## external/package/firmware-nvidia/Config.in
```kconfig
config BR2_PACKAGE_FIRMWARE_NVIDIA
	bool "firmware-nvidia (for the package repository)"
	depends on BR2_x86_64
	help
	  NVIDIA GPU firmware, including GeForce RTX 20/30/40/50 (GSP); reboot after installing.

	  For the open-source nouveau driver: kernel 6.18 uses the GSP
	  firmware 570.144 (the older 535 files and Tegra SoC firmware
	  are left out). In the package repository, not on the ISO: the
	  kernel only loads nouveau once this is installed
	  (/etc/modprobe.d/gpu.conf).
```

## external/package/jwm/Config.in
```kconfig
config BR2_PACKAGE_JWM
	bool "jwm"
	depends on BR2_PACKAGE_XORG7
	select BR2_PACKAGE_XLIB_LIBX11
	select BR2_PACKAGE_XLIB_LIBXEXT
	select BR2_PACKAGE_XLIB_LIBXFT
	select BR2_PACKAGE_XLIB_LIBXINERAMA
	select BR2_PACKAGE_XLIB_LIBXMU
	select BR2_PACKAGE_XLIB_LIBXPM
	select BR2_PACKAGE_XLIB_LIBXRENDER
	select BR2_PACKAGE_XLIB_LIBXRANDR
	select BR2_PACKAGE_LIBPNG
	select BR2_PACKAGE_JPEG
	select BR2_PACKAGE_CAIRO
	help
	  JWM (Joe's Window Manager): a light X11 window manager with a
	  built-in panel, task list, system tray, clock and menus.

	  https://joewing.net/projects/jwm/
```

## external/package/kde-accountsservice/Config.in
```kconfig
config BR2_PACKAGE_KDE_ACCOUNTSSERVICE
	bool "kde-accountsservice"
	select BR2_PACKAGE_LIBGLIB2
	select BR2_PACKAGE_POLKIT
	select BR2_PACKAGE_KDE_ELOGIND
	select BR2_PACKAGE_LIBXCRYPT
	help
	  accountsservice: user accounts over D-Bus, for SDDM and Plasma.
```

## external/package/kde-appstream/Config.in
```kconfig
config BR2_PACKAGE_KDE_APPSTREAM
	bool "kde-appstream"
	select BR2_PACKAGE_LIBGLIB2
	select BR2_PACKAGE_LIBXML2
	select BR2_PACKAGE_LIBYAML
	select BR2_PACKAGE_LIBCURL
	select BR2_PACKAGE_LIBXMLB
	select BR2_PACKAGE_ZSTD
	help
	  AppStream 1.2 with AppStreamQt, for Discover.
```

## external/package/kde-ark/Config.in
```kconfig
config BR2_PACKAGE_KDE_ARK
	bool "kde-ark"
	select BR2_PACKAGE_KF6_EXTRA_CMAKE_MODULES
	select BR2_PACKAGE_KF6_KARCHIVE
	select BR2_PACKAGE_KF6_KCONFIG
	select BR2_PACKAGE_KF6_KCOREADDONS
	select BR2_PACKAGE_KF6_KCRASH
	select BR2_PACKAGE_KF6_KDBUSADDONS
	select BR2_PACKAGE_KF6_KFILEMETADATA
	select BR2_PACKAGE_KF6_KI18N
	select BR2_PACKAGE_KF6_KICONTHEMES
	select BR2_PACKAGE_KF6_KIO
	select BR2_PACKAGE_KF6_KPARTS
	select BR2_PACKAGE_KF6_KPTY
	select BR2_PACKAGE_KF6_KSERVICE
	select BR2_PACKAGE_KF6_KWIDGETSADDONS
	select BR2_PACKAGE_KF6_KWINDOWSYSTEM
	select BR2_PACKAGE_LIBARCHIVE
	select BR2_PACKAGE_QT6BASE
	select BR2_PACKAGE_ZLIB
	help
	  KDE gear: ark 26.08.3. GENERATED by scripts/kde-gen.py.
```

## external/package/kde-aurorae/Config.in
```kconfig
config BR2_PACKAGE_KDE_AURORAE
	bool "kde-aurorae"
	select BR2_PACKAGE_KDE_KDECORATION
	select BR2_PACKAGE_KF6_EXTRA_CMAKE_MODULES
	select BR2_PACKAGE_KF6_KCMUTILS
	select BR2_PACKAGE_KF6_KCONFIG
	select BR2_PACKAGE_KF6_KCOREADDONS
	select BR2_PACKAGE_KF6_KI18N
	select BR2_PACKAGE_KF6_KNEWSTUFF
	select BR2_PACKAGE_KF6_KPACKAGE
	select BR2_PACKAGE_KF6_KSVG
	select BR2_PACKAGE_QT6BASE
	select BR2_PACKAGE_QT6DECLARATIVE
	help
	  KDE plasma: aurorae 6.8.3. GENERATED by scripts/kde-gen.py.
```

## external/package/kde-baloo-widgets/Config.in
```kconfig
config BR2_PACKAGE_KDE_BALOO_WIDGETS
	bool "kde-baloo-widgets"
	select BR2_PACKAGE_KF6_BALOO
	select BR2_PACKAGE_KF6_EXTRA_CMAKE_MODULES
	select BR2_PACKAGE_KF6_KCONFIG
	select BR2_PACKAGE_KF6_KFILEMETADATA
	select BR2_PACKAGE_KF6_KI18N
	select BR2_PACKAGE_KF6_KIO
	select BR2_PACKAGE_QT6BASE
	help
	  KDE gear: baloo-widgets 26.08.3. GENERATED by scripts/kde-gen.py.
```

## external/package/kde-bluedevil/Config.in
```kconfig
config BR2_PACKAGE_KDE_BLUEDEVIL
	bool "kde-bluedevil"
	select BR2_PACKAGE_KDE_LIBPLASMA
	select BR2_PACKAGE_KF6_BLUEZ_QT
	select BR2_PACKAGE_KF6_EXTRA_CMAKE_MODULES
	select BR2_PACKAGE_KF6_KAUTH
	select BR2_PACKAGE_KF6_KCMUTILS
	select BR2_PACKAGE_KF6_KCODECS
	select BR2_PACKAGE_KF6_KCOMPLETION
	select BR2_PACKAGE_KF6_KCONFIG
	select BR2_PACKAGE_KF6_KCONFIGWIDGETS
	select BR2_PACKAGE_KF6_KCOREADDONS
	select BR2_PACKAGE_KF6_KDBUSADDONS
	select BR2_PACKAGE_KF6_KI18N
	select BR2_PACKAGE_KF6_KIO
	select BR2_PACKAGE_KF6_KITEMVIEWS
	select BR2_PACKAGE_KF6_KJOBWIDGETS
	select BR2_PACKAGE_KF6_KNOTIFICATIONS
	select BR2_PACKAGE_KF6_KSERVICE
	select BR2_PACKAGE_KF6_KWIDGETSADDONS
	select BR2_PACKAGE_KF6_KWINDOWSYSTEM
	select BR2_PACKAGE_KF6_KXMLGUI
	select BR2_PACKAGE_KF6_SOLID
	select BR2_PACKAGE_QT6BASE
	select BR2_PACKAGE_QT6DECLARATIVE
	select BR2_PACKAGE_SHARED_MIME_INFO
	help
	  KDE plasma: bluedevil 6.8.3. GENERATED by scripts/kde-gen.py.
```

## external/package/kde-breeze/Config.in
```kconfig
config BR2_PACKAGE_KDE_BREEZE
	bool "kde-breeze"
	select BR2_PACKAGE_KDE_KDECORATION
	select BR2_PACKAGE_KF6_EXTRA_CMAKE_MODULES
	select BR2_PACKAGE_KF6_FRAMEWORKINTEGRATION
	select BR2_PACKAGE_KF6_KCMUTILS
	select BR2_PACKAGE_KF6_KCOLORSCHEME
	select BR2_PACKAGE_KF6_KCONFIG
	select BR2_PACKAGE_KF6_KCOREADDONS
	select BR2_PACKAGE_KF6_KGUIADDONS
	select BR2_PACKAGE_KF6_KI18N
	select BR2_PACKAGE_KF6_KICONTHEMES
	select BR2_PACKAGE_KF6_KIRIGAMI
	select BR2_PACKAGE_KF6_KWINDOWSYSTEM
	select BR2_PACKAGE_QT6BASE
	select BR2_PACKAGE_QT6DECLARATIVE
	select BR2_PACKAGE_QT6SVG
	help
	  KDE plasma: breeze 6.8.3. GENERATED by scripts/kde-gen.py.
```

## external/package/kde-discover/Config.in
```kconfig
config BR2_PACKAGE_KDE_DISCOVER
	bool "kde-discover"
	select BR2_PACKAGE_KDE_APPSTREAM
	select BR2_PACKAGE_KDE_KIRIGAMI_ADDONS
	select BR2_PACKAGE_KDE_QCORO
	select BR2_PACKAGE_KF6_ATTICA
	select BR2_PACKAGE_KF6_EXTRA_CMAKE_MODULES
	select BR2_PACKAGE_KF6_KARCHIVE
	select BR2_PACKAGE_KF6_KAUTH
	select BR2_PACKAGE_KF6_KCMUTILS
	select BR2_PACKAGE_KF6_KCODECS
	select BR2_PACKAGE_KF6_KCONFIG
	select BR2_PACKAGE_KF6_KCONFIGWIDGETS
	select BR2_PACKAGE_KF6_KCOREADDONS
	select BR2_PACKAGE_KF6_KCRASH
	select BR2_PACKAGE_KF6_KDBUSADDONS
	select BR2_PACKAGE_KF6_KI18N
	select BR2_PACKAGE_KF6_KIDLETIME
	select BR2_PACKAGE_KF6_KIO
	select BR2_PACKAGE_KF6_KITEMMODELS
	select BR2_PACKAGE_KF6_KNEWSTUFF
	select BR2_PACKAGE_KF6_KNOTIFICATIONS
	select BR2_PACKAGE_KF6_KSERVICE
	select BR2_PACKAGE_KF6_KSTATUSNOTIFIERITEM
	select BR2_PACKAGE_KF6_KWIDGETSADDONS
	select BR2_PACKAGE_KF6_KWINDOWSYSTEM
	select BR2_PACKAGE_KF6_KXMLGUI
	select BR2_PACKAGE_KF6_PURPOSE
	select BR2_PACKAGE_QT6BASE
	select BR2_PACKAGE_QT6DECLARATIVE
	help
	  KDE plasma: discover 6.8.3. GENERATED by scripts/kde-gen.py.
```

## external/package/kde-dolphin/Config.in
```kconfig
config BR2_PACKAGE_KDE_DOLPHIN
	bool "kde-dolphin"
	select BR2_PACKAGE_KDE_BALOO_WIDGETS
	select BR2_PACKAGE_KDE_KIO_EXTRAS
	select BR2_PACKAGE_KF6_BALOO
	select BR2_PACKAGE_KF6_EXTRA_CMAKE_MODULES
	select BR2_PACKAGE_KF6_KBOOKMARKS
	select BR2_PACKAGE_KF6_KCMUTILS
	select BR2_PACKAGE_KF6_KCODECS
	select BR2_PACKAGE_KF6_KCOLORSCHEME
	select BR2_PACKAGE_KF6_KCOMPLETION
	select BR2_PACKAGE_KF6_KCONFIG
	select BR2_PACKAGE_KF6_KCOREADDONS
	select BR2_PACKAGE_KF6_KCRASH
	select BR2_PACKAGE_KF6_KDBUSADDONS
	select BR2_PACKAGE_KF6_KFILEMETADATA
	select BR2_PACKAGE_KF6_KI18N
	select BR2_PACKAGE_KF6_KICONTHEMES
	select BR2_PACKAGE_KF6_KIO
	select BR2_PACKAGE_KF6_KNEWSTUFF
	select BR2_PACKAGE_KF6_KNOTIFICATIONS
	select BR2_PACKAGE_KF6_KPARTS
	select BR2_PACKAGE_KF6_KTEXTWIDGETS
	select BR2_PACKAGE_KF6_KWINDOWSYSTEM
	select BR2_PACKAGE_KF6_SOLID
	select BR2_PACKAGE_QT6BASE
	select BR2_PACKAGE_QT6MULTIMEDIA
	help
	  KDE gear: dolphin 26.08.3. GENERATED by scripts/kde-gen.py.
```

## external/package/kde-dragon/Config.in
```kconfig
config BR2_PACKAGE_KDE_DRAGON
	bool "kde-dragon"
	select BR2_PACKAGE_KF6_EXTRA_CMAKE_MODULES
	select BR2_PACKAGE_KF6_KCONFIG
	select BR2_PACKAGE_KF6_KCOREADDONS
	select BR2_PACKAGE_KF6_KCRASH
	select BR2_PACKAGE_KF6_KI18N
	select BR2_PACKAGE_KF6_KIO
	select BR2_PACKAGE_KF6_KIRIGAMI
	select BR2_PACKAGE_QT6BASE
	select BR2_PACKAGE_QT6DECLARATIVE
	select BR2_PACKAGE_QT6MULTIMEDIA
	help
	  KDE gear: dragon 26.08.3. GENERATED by scripts/kde-gen.py.
```
