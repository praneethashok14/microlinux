## external/package/kde-filelight/Config.in
```kconfig
config BR2_PACKAGE_KDE_FILELIGHT
	bool "kde-filelight"
	select BR2_PACKAGE_KF6_EXTRA_CMAKE_MODULES
	select BR2_PACKAGE_KF6_KCOLORSCHEME
	select BR2_PACKAGE_KF6_KCONFIG
	select BR2_PACKAGE_KF6_KCRASH
	select BR2_PACKAGE_KF6_KI18N
	select BR2_PACKAGE_KF6_KIO
	select BR2_PACKAGE_QT6BASE
	select BR2_PACKAGE_QT6DECLARATIVE
	help
	  KDE gear: filelight 26.08.3. GENERATED by scripts/kde-gen.py.
```

## external/package/kde-gwenview/Config.in
```kconfig
config BR2_PACKAGE_KDE_GWENVIEW
	bool "kde-gwenview"
	select BR2_PACKAGE_EXIV2
	select BR2_PACKAGE_JPEG
	select BR2_PACKAGE_KDE_LIBKDCRAW
	select BR2_PACKAGE_KDE_PLASMA_ACTIVITIES
	select BR2_PACKAGE_KF6_EXTRA_CMAKE_MODULES
	select BR2_PACKAGE_KF6_KCONFIG
	select BR2_PACKAGE_KF6_KCOREADDONS
	select BR2_PACKAGE_KF6_KCRASH
	select BR2_PACKAGE_KF6_KDBUSADDONS
	select BR2_PACKAGE_KF6_KGLOBALACCEL
	select BR2_PACKAGE_KF6_KGUIADDONS
	select BR2_PACKAGE_KF6_KI18N
	select BR2_PACKAGE_KF6_KICONTHEMES
	select BR2_PACKAGE_KF6_KIO
	select BR2_PACKAGE_KF6_KITEMMODELS
	select BR2_PACKAGE_KF6_KNEWSTUFF
	select BR2_PACKAGE_KF6_KNOTIFICATIONS
	select BR2_PACKAGE_KF6_KPARTS
	select BR2_PACKAGE_KF6_KWIDGETSADDONS
	select BR2_PACKAGE_KF6_KWINDOWSYSTEM
	select BR2_PACKAGE_KF6_KXMLGUI
	select BR2_PACKAGE_KF6_PURPOSE
	select BR2_PACKAGE_LCMS2
	select BR2_PACKAGE_LIBPNG
	select BR2_PACKAGE_QT6BASE
	select BR2_PACKAGE_QT6MULTIMEDIA
	select BR2_PACKAGE_QT6SVG
	select BR2_PACKAGE_QT6WAYLAND
	select BR2_PACKAGE_TIFF
	select BR2_PACKAGE_WAYLAND
	select BR2_PACKAGE_WAYLAND_PROTOCOLS
	select BR2_PACKAGE_XLIB_LIBX11
	help
	  KDE gear: gwenview 26.08.3. GENERATED by scripts/kde-gen.py.
```

## external/package/kde-kactivitymanagerd/Config.in
```kconfig
config BR2_PACKAGE_KDE_KACTIVITYMANAGERD
	bool "kde-kactivitymanagerd"
	select BR2_PACKAGE_BOOST
	select BR2_PACKAGE_KF6_EXTRA_CMAKE_MODULES
	select BR2_PACKAGE_KF6_KAUTH
	select BR2_PACKAGE_KF6_KCODECS
	select BR2_PACKAGE_KF6_KCONFIG
	select BR2_PACKAGE_KF6_KCONFIGWIDGETS
	select BR2_PACKAGE_KF6_KCOREADDONS
	select BR2_PACKAGE_KF6_KCRASH
	select BR2_PACKAGE_KF6_KDBUSADDONS
	select BR2_PACKAGE_KF6_KGLOBALACCEL
	select BR2_PACKAGE_KF6_KI18N
	select BR2_PACKAGE_KF6_KIO
	select BR2_PACKAGE_KF6_KSERVICE
	select BR2_PACKAGE_KF6_KWIDGETSADDONS
	select BR2_PACKAGE_KF6_KXMLGUI
	select BR2_PACKAGE_QT6BASE
	help
	  KDE plasma: kactivitymanagerd 6.8.3. GENERATED by scripts/kde-gen.py.
```

## external/package/kde-kate/Config.in
```kconfig
config BR2_PACKAGE_KDE_KATE
	bool "kde-kate"
	select BR2_PACKAGE_KF6_BREEZE_ICONS
	select BR2_PACKAGE_KF6_EXTRA_CMAKE_MODULES
	select BR2_PACKAGE_KF6_KI18N
	select BR2_PACKAGE_KF6_KICONTHEMES
	select BR2_PACKAGE_KF6_KNEWSTUFF
	select BR2_PACKAGE_KF6_KTEXTEDITOR
	select BR2_PACKAGE_QT6BASE
	select BR2_PACKAGE_QT6DECLARATIVE
	help
	  KDE gear: kate 26.08.3. GENERATED by scripts/kde-gen.py.
```

## external/package/kde-kcalc/Config.in
```kconfig
config BR2_PACKAGE_KDE_KCALC
	bool "kde-kcalc"
	select BR2_PACKAGE_GMP
	select BR2_PACKAGE_KF6_EXTRA_CMAKE_MODULES
	select BR2_PACKAGE_KF6_KCOLORSCHEME
	select BR2_PACKAGE_KF6_KCONFIGWIDGETS
	select BR2_PACKAGE_KF6_KCOREADDONS
	select BR2_PACKAGE_KF6_KCRASH
	select BR2_PACKAGE_KF6_KGUIADDONS
	select BR2_PACKAGE_KF6_KI18N
	select BR2_PACKAGE_KF6_KICONTHEMES
	select BR2_PACKAGE_KF6_KNOTIFICATIONS
	select BR2_PACKAGE_KF6_KXMLGUI
	select BR2_PACKAGE_MPC
	select BR2_PACKAGE_MPFR
	select BR2_PACKAGE_QT6BASE
	help
	  KDE gear: kcalc 26.08.3. GENERATED by scripts/kde-gen.py.
```

## external/package/kde-kcharselect/Config.in
```kconfig
config BR2_PACKAGE_KDE_KCHARSELECT
	bool "kde-kcharselect"
	select BR2_PACKAGE_KF6_EXTRA_CMAKE_MODULES
	select BR2_PACKAGE_KF6_KBOOKMARKS
	select BR2_PACKAGE_KF6_KCOREADDONS
	select BR2_PACKAGE_KF6_KCRASH
	select BR2_PACKAGE_KF6_KI18N
	select BR2_PACKAGE_KF6_KWIDGETSADDONS
	select BR2_PACKAGE_KF6_KXMLGUI
	select BR2_PACKAGE_QT6BASE
	help
	  KDE gear: kcharselect 26.08.3. GENERATED by scripts/kde-gen.py.
```

## external/package/kde-kcolorchooser/Config.in
```kconfig
config BR2_PACKAGE_KDE_KCOLORCHOOSER
	bool "kde-kcolorchooser"
	select BR2_PACKAGE_KF6_EXTRA_CMAKE_MODULES
	select BR2_PACKAGE_KF6_KI18N
	select BR2_PACKAGE_KF6_KXMLGUI
	select BR2_PACKAGE_QT6BASE
	help
	  KDE gear: kcolorchooser 26.08.3. GENERATED by scripts/kde-gen.py.
```

## external/package/kde-kde-cli-tools/Config.in
```kconfig
config BR2_PACKAGE_KDE_KDE_CLI_TOOLS
	bool "kde-kde-cli-tools"
	select BR2_PACKAGE_KF6_EXTRA_CMAKE_MODULES
	select BR2_PACKAGE_KF6_KCMUTILS
	select BR2_PACKAGE_KF6_KCOMPLETION
	select BR2_PACKAGE_KF6_KCONFIG
	select BR2_PACKAGE_KF6_KCOREADDONS
	select BR2_PACKAGE_KF6_KDESU
	select BR2_PACKAGE_KF6_KI18N
	select BR2_PACKAGE_KF6_KICONTHEMES
	select BR2_PACKAGE_KF6_KIO
	select BR2_PACKAGE_KF6_KPARTS
	select BR2_PACKAGE_KF6_KSERVICE
	select BR2_PACKAGE_KF6_KWIDGETSADDONS
	select BR2_PACKAGE_KF6_KWINDOWSYSTEM
	select BR2_PACKAGE_QT6BASE
	select BR2_PACKAGE_QT6SVG
	help
	  KDE plasma: kde-cli-tools 6.8.3. GENERATED by scripts/kde-gen.py.
```

## external/package/kde-kdecoration/Config.in
```kconfig
config BR2_PACKAGE_KDE_KDECORATION
	bool "kde-kdecoration"
	select BR2_PACKAGE_KF6_EXTRA_CMAKE_MODULES
	select BR2_PACKAGE_KF6_KI18N
	select BR2_PACKAGE_QT6BASE
	help
	  KDE plasma: kdecoration 6.8.3. GENERATED by scripts/kde-gen.py.
```

## external/package/kde-kdegraphics-mobipocket/Config.in
```kconfig
config BR2_PACKAGE_KDE_KDEGRAPHICS_MOBIPOCKET
	bool "kde-kdegraphics-mobipocket"
	select BR2_PACKAGE_KF6_EXTRA_CMAKE_MODULES
	select BR2_PACKAGE_QT6BASE
	help
	  KDE gear: kdegraphics-mobipocket 26.08.3. GENERATED by scripts/kde-gen.py.
```

## external/package/kde-kdegraphics-thumbnailers/Config.in
```kconfig
config BR2_PACKAGE_KDE_KDEGRAPHICS_THUMBNAILERS
	bool "kde-kdegraphics-thumbnailers"
	select BR2_PACKAGE_KDE_KDEGRAPHICS_MOBIPOCKET
	select BR2_PACKAGE_KDE_LIBKDCRAW
	select BR2_PACKAGE_KDE_LIBKEXIV2
	select BR2_PACKAGE_KF6_EXTRA_CMAKE_MODULES
	select BR2_PACKAGE_KF6_KARCHIVE
	select BR2_PACKAGE_KF6_KIO
	select BR2_PACKAGE_QT6BASE
	help
	  KDE gear: kdegraphics-thumbnailers 26.08.3. GENERATED by scripts/kde-gen.py.
```

## external/package/kde-kdeplasma-addons/Config.in
```kconfig
config BR2_PACKAGE_KDE_KDEPLASMA_ADDONS
	bool "kde-kdeplasma-addons"
	select BR2_PACKAGE_ICU
	select BR2_PACKAGE_KDE_KIRIGAMI_ADDONS
	select BR2_PACKAGE_KDE_LIBPLASMA
	select BR2_PACKAGE_KDE_PLASMA_DESKTOP
	select BR2_PACKAGE_KDE_PLASMA_WORKSPACE
	select BR2_PACKAGE_KF6_ATTICA
	select BR2_PACKAGE_KF6_EXTRA_CMAKE_MODULES
	select BR2_PACKAGE_KF6_KAUTH
	select BR2_PACKAGE_KF6_KCMUTILS
	select BR2_PACKAGE_KF6_KCODECS
	select BR2_PACKAGE_KF6_KCOMPLETION
	select BR2_PACKAGE_KF6_KCONFIG
	select BR2_PACKAGE_KF6_KCONFIGWIDGETS
	select BR2_PACKAGE_KF6_KCOREADDONS
	select BR2_PACKAGE_KF6_KGLOBALACCEL
	select BR2_PACKAGE_KF6_KHOLIDAYS
	select BR2_PACKAGE_KF6_KI18N
	select BR2_PACKAGE_KF6_KIO
	select BR2_PACKAGE_KF6_KJOBWIDGETS
	select BR2_PACKAGE_KF6_KNEWSTUFF
	select BR2_PACKAGE_KF6_KNOTIFICATIONS
	select BR2_PACKAGE_KF6_KPACKAGE
	select BR2_PACKAGE_KF6_KRUNNER
	select BR2_PACKAGE_KF6_KSERVICE
	select BR2_PACKAGE_KF6_KUNITCONVERSION
	select BR2_PACKAGE_KF6_KWIDGETSADDONS
	select BR2_PACKAGE_KF6_KXMLGUI
	select BR2_PACKAGE_KF6_SOLID
	select BR2_PACKAGE_KF6_SONNET
	select BR2_PACKAGE_QT6BASE
	select BR2_PACKAGE_QT6DECLARATIVE
	select BR2_PACKAGE_QT6QUICK3D
	help
	  KDE plasma: kdeplasma-addons 6.8.3. GENERATED by scripts/kde-gen.py.
```

## external/package/kde-kdialog/Config.in
```kconfig
config BR2_PACKAGE_KDE_KDIALOG
	bool "kde-kdialog"
	select BR2_PACKAGE_KF6_EXTRA_CMAKE_MODULES
	select BR2_PACKAGE_KF6_KDBUSADDONS
	select BR2_PACKAGE_KF6_KGUIADDONS
	select BR2_PACKAGE_KF6_KICONTHEMES
	select BR2_PACKAGE_KF6_KIO
	select BR2_PACKAGE_KF6_KNOTIFICATIONS
	select BR2_PACKAGE_KF6_KTEXTWIDGETS
	select BR2_PACKAGE_KF6_KWINDOWSYSTEM
	select BR2_PACKAGE_QT6BASE
	select BR2_PACKAGE_XLIB_LIBX11
	help
	  KDE gear: kdialog 26.08.3. GENERATED by scripts/kde-gen.py.
```

## external/package/kde-keditbookmarks/Config.in
```kconfig
config BR2_PACKAGE_KDE_KEDITBOOKMARKS
	bool "kde-keditbookmarks"
	select BR2_PACKAGE_KF6_EXTRA_CMAKE_MODULES
	select BR2_PACKAGE_KF6_KBOOKMARKS
	select BR2_PACKAGE_KF6_KCODECS
	select BR2_PACKAGE_KF6_KCONFIGWIDGETS
	select BR2_PACKAGE_KF6_KCOREADDONS
	select BR2_PACKAGE_KF6_KCRASH
	select BR2_PACKAGE_KF6_KI18N
	select BR2_PACKAGE_KF6_KICONTHEMES
	select BR2_PACKAGE_KF6_KIO
	select BR2_PACKAGE_KF6_KPARTS
	select BR2_PACKAGE_KF6_KWIDGETSADDONS
	select BR2_PACKAGE_KF6_KWINDOWSYSTEM
	select BR2_PACKAGE_QT6BASE
	select BR2_PACKAGE_XLIB_LIBX11
	help
	  KDE gear: keditbookmarks 26.08.3. GENERATED by scripts/kde-gen.py.
```

## external/package/kde-kglobalacceld/Config.in
```kconfig
config BR2_PACKAGE_KDE_KGLOBALACCELD
	bool "kde-kglobalacceld"
	select BR2_PACKAGE_KF6_EXTRA_CMAKE_MODULES
	select BR2_PACKAGE_KF6_KCONFIG
	select BR2_PACKAGE_KF6_KCOREADDONS
	select BR2_PACKAGE_KF6_KCRASH
	select BR2_PACKAGE_KF6_KDBUSADDONS
	select BR2_PACKAGE_KF6_KGLOBALACCEL
	select BR2_PACKAGE_KF6_KIO
	select BR2_PACKAGE_KF6_KJOBWIDGETS
	select BR2_PACKAGE_KF6_KSERVICE
	select BR2_PACKAGE_KF6_KWINDOWSYSTEM
	select BR2_PACKAGE_QT6BASE
	help
	  KDE plasma: kglobalacceld 6.8.3. GENERATED by scripts/kde-gen.py.
```

## external/package/kde-kinfocenter/Config.in
```kconfig
config BR2_PACKAGE_KDE_KINFOCENTER
	bool "kde-kinfocenter"
	select BR2_PACKAGE_EUDEV
	select BR2_PACKAGE_KDE_PLASMA_SYSTEMMONITOR
	select BR2_PACKAGE_KDE_SYSTEMSETTINGS
	select BR2_PACKAGE_KDE_XDG_DESKTOP_PORTAL_KDE
	select BR2_PACKAGE_KF6_EXTRA_CMAKE_MODULES
	select BR2_PACKAGE_KF6_KAUTH
	select BR2_PACKAGE_KF6_KCMUTILS
	select BR2_PACKAGE_KF6_KCODECS
	select BR2_PACKAGE_KF6_KCOMPLETION
	select BR2_PACKAGE_KF6_KCONFIG
	select BR2_PACKAGE_KF6_KCOREADDONS
	select BR2_PACKAGE_KF6_KI18N
	select BR2_PACKAGE_KF6_KIO
	select BR2_PACKAGE_KF6_KJOBWIDGETS
	select BR2_PACKAGE_KF6_KSERVICE
	select BR2_PACKAGE_KF6_KWINDOWSYSTEM
	select BR2_PACKAGE_KF6_SOLID
	select BR2_PACKAGE_LIBUSB
	select BR2_PACKAGE_QT6BASE
	select BR2_PACKAGE_QT6DECLARATIVE
	select BR2_PACKAGE_QT6GRAPHS
	help
	  KDE plasma: kinfocenter 6.8.3. GENERATED by scripts/kde-gen.py.
```

## external/package/kde-kio-extras/Config.in
```kconfig
config BR2_PACKAGE_KDE_KIO_EXTRAS
	bool "kde-kio-extras"
	select BR2_PACKAGE_KDE_LIBKEXIV2
	select BR2_PACKAGE_KDE_PLASMA_ACTIVITIES
	select BR2_PACKAGE_KDE_PLASMA_ACTIVITIES_STATS
	select BR2_PACKAGE_KDE_QCORO
	select BR2_PACKAGE_KF6_EXTRA_CMAKE_MODULES
	select BR2_PACKAGE_KF6_KARCHIVE
	select BR2_PACKAGE_KF6_KCMUTILS
	select BR2_PACKAGE_KF6_KCONFIG
	select BR2_PACKAGE_KF6_KCONFIGWIDGETS
	select BR2_PACKAGE_KF6_KCOREADDONS
	select BR2_PACKAGE_KF6_KDBUSADDONS
	select BR2_PACKAGE_KF6_KDNSSD
	select BR2_PACKAGE_KF6_KGUIADDONS
	select BR2_PACKAGE_KF6_KI18N
	select BR2_PACKAGE_KF6_KIO
	select BR2_PACKAGE_KF6_SOLID
	select BR2_PACKAGE_KF6_SYNTAX_HIGHLIGHTING
	select BR2_PACKAGE_LIBSSH
	select BR2_PACKAGE_QT6BASE
	select BR2_PACKAGE_QT6SVG
	select BR2_PACKAGE_SHARED_MIME_INFO
	select BR2_PACKAGE_TAGLIB
	select BR2_PACKAGE_XLIB_LIBX11
	help
	  KDE gear: kio-extras 26.08.3. GENERATED by scripts/kde-gen.py.
```

## external/package/kde-kirigami-addons/Config.in
```kconfig
config BR2_PACKAGE_KDE_KIRIGAMI_ADDONS
	bool "kde-kirigami-addons"
	select BR2_PACKAGE_KF6_EXTRA_CMAKE_MODULES
	select BR2_PACKAGE_KF6_KCOLORSCHEME
	select BR2_PACKAGE_KF6_KCONFIG
	select BR2_PACKAGE_KF6_KCOREADDONS
	select BR2_PACKAGE_KF6_KCRASH
	select BR2_PACKAGE_KF6_KGLOBALACCEL
	select BR2_PACKAGE_KF6_KGUIADDONS
	select BR2_PACKAGE_KF6_KI18N
	select BR2_PACKAGE_KF6_KICONTHEMES
	select BR2_PACKAGE_KF6_KIRIGAMI
	select BR2_PACKAGE_QT6BASE
	select BR2_PACKAGE_QT6DECLARATIVE
	select BR2_PACKAGE_QT6SVG
	help
	  KDE other: kirigami-addons 1.16.1. GENERATED by scripts/kde-gen.py.
```

## external/package/kde-kmahjongg/Config.in
```kconfig
config BR2_PACKAGE_KDE_KMAHJONGG
	bool "kde-kmahjongg"
	select BR2_PACKAGE_KDE_LIBKDEGAMES
	select BR2_PACKAGE_KDE_LIBKMAHJONGG
	select BR2_PACKAGE_KF6_EXTRA_CMAKE_MODULES
	select BR2_PACKAGE_KF6_KCONFIG
	select BR2_PACKAGE_KF6_KCOREADDONS
	select BR2_PACKAGE_KF6_KCRASH
	select BR2_PACKAGE_KF6_KDBUSADDONS
	select BR2_PACKAGE_KF6_KI18N
	select BR2_PACKAGE_KF6_KNEWSTUFF
	select BR2_PACKAGE_KF6_KXMLGUI
	select BR2_PACKAGE_QT6BASE
	select BR2_PACKAGE_QT6SVG
	help
	  KDE gear: kmahjongg 26.08.3. GENERATED by scripts/kde-gen.py.
```

## external/package/kde-kmenuedit/Config.in
```kconfig
config BR2_PACKAGE_KDE_KMENUEDIT
	bool "kde-kmenuedit"
	select BR2_PACKAGE_KF6_EXTRA_CMAKE_MODULES
	select BR2_PACKAGE_KF6_KCRASH
	select BR2_PACKAGE_KF6_KDBUSADDONS
	select BR2_PACKAGE_KF6_KGLOBALACCEL
	select BR2_PACKAGE_KF6_KI18N
	select BR2_PACKAGE_KF6_KICONTHEMES
	select BR2_PACKAGE_KF6_KIO
	select BR2_PACKAGE_KF6_KITEMVIEWS
	select BR2_PACKAGE_KF6_KWINDOWSYSTEM
	select BR2_PACKAGE_KF6_KXMLGUI
	select BR2_PACKAGE_KF6_SONNET
	select BR2_PACKAGE_QT6BASE
	help
	  KDE plasma: kmenuedit 6.8.3. GENERATED by scripts/kde-gen.py.
```

## external/package/kde-kmines/Config.in
```kconfig
config BR2_PACKAGE_KDE_KMINES
	bool "kde-kmines"
	select BR2_PACKAGE_KDE_LIBKDEGAMES
	select BR2_PACKAGE_KF6_EXTRA_CMAKE_MODULES
	select BR2_PACKAGE_KF6_KCONFIG
	select BR2_PACKAGE_KF6_KCONFIGWIDGETS
	select BR2_PACKAGE_KF6_KCOREADDONS
	select BR2_PACKAGE_KF6_KCRASH
	select BR2_PACKAGE_KF6_KDBUSADDONS
	select BR2_PACKAGE_KF6_KI18N
	select BR2_PACKAGE_KF6_KICONTHEMES
	select BR2_PACKAGE_KF6_KTEXTWIDGETS
	select BR2_PACKAGE_KF6_KWIDGETSADDONS
	select BR2_PACKAGE_KF6_KXMLGUI
	select BR2_PACKAGE_QT6BASE
	help
	  KDE gear: kmines 26.08.3. GENERATED by scripts/kde-gen.py.
```

## external/package/kde-knighttime/Config.in
```kconfig
config BR2_PACKAGE_KDE_KNIGHTTIME
	bool "kde-knighttime"
	select BR2_PACKAGE_KF6_EXTRA_CMAKE_MODULES
	select BR2_PACKAGE_KF6_KCONFIG
	select BR2_PACKAGE_KF6_KCOREADDONS
	select BR2_PACKAGE_KF6_KDBUSADDONS
	select BR2_PACKAGE_KF6_KHOLIDAYS
	select BR2_PACKAGE_KF6_KI18N
	select BR2_PACKAGE_QT6BASE
	help
	  KDE plasma: knighttime 6.8.3. GENERATED by scripts/kde-gen.py.
```

## external/package/kde-konsole/Config.in
```kconfig
config BR2_PACKAGE_KDE_KONSOLE
	bool "kde-konsole"
	select BR2_PACKAGE_ICU
	select BR2_PACKAGE_KDE_QCORO
	select BR2_PACKAGE_KF6_EXTRA_CMAKE_MODULES
	select BR2_PACKAGE_KF6_KBOOKMARKS
	select BR2_PACKAGE_KF6_KCONFIG
	select BR2_PACKAGE_KF6_KCONFIGWIDGETS
	select BR2_PACKAGE_KF6_KCOREADDONS
	select BR2_PACKAGE_KF6_KCRASH
	select BR2_PACKAGE_KF6_KDBUSADDONS
	select BR2_PACKAGE_KF6_KGLOBALACCEL
	select BR2_PACKAGE_KF6_KGUIADDONS
	select BR2_PACKAGE_KF6_KI18N
	select BR2_PACKAGE_KF6_KICONTHEMES
	select BR2_PACKAGE_KF6_KIO
	select BR2_PACKAGE_KF6_KNEWSTUFF
	select BR2_PACKAGE_KF6_KNOTIFICATIONS
	select BR2_PACKAGE_KF6_KNOTIFYCONFIG
	select BR2_PACKAGE_KF6_KPARTS
	select BR2_PACKAGE_KF6_KPTY
	select BR2_PACKAGE_KF6_KSERVICE
	select BR2_PACKAGE_KF6_KTEXTWIDGETS
	select BR2_PACKAGE_KF6_KWIDGETSADDONS
	select BR2_PACKAGE_KF6_KWINDOWSYSTEM
	select BR2_PACKAGE_KF6_KXMLGUI
	select BR2_PACKAGE_LIBSSH
	select BR2_PACKAGE_QT6BASE
	select BR2_PACKAGE_QT6MULTIMEDIA
	help
	  KDE gear: konsole 26.08.3. GENERATED by scripts/kde-gen.py.
```

## external/package/kde-kpat/Config.in
```kconfig
config BR2_PACKAGE_KDE_KPAT
	bool "kde-kpat"
	select BR2_PACKAGE_KDE_LIBKDEGAMES
	select BR2_PACKAGE_KF6_EXTRA_CMAKE_MODULES
	select BR2_PACKAGE_KF6_KIO
	select BR2_PACKAGE_QT6BASE
	select BR2_PACKAGE_QT6SVG
	select BR2_PACKAGE_SHARED_MIME_INFO
	help
	  KDE gear: kpat 26.08.3. GENERATED by scripts/kde-gen.py.
```

## external/package/kde-kpipewire/Config.in
```kconfig
config BR2_PACKAGE_KDE_KPIPEWIRE
	bool "kde-kpipewire"
	select BR2_PACKAGE_KDE_PLASMA_WAYLAND_PROTOCOLS
	select BR2_PACKAGE_KF6_EXTRA_CMAKE_MODULES
	select BR2_PACKAGE_KF6_KCOREADDONS
	select BR2_PACKAGE_KF6_KI18N
	select BR2_PACKAGE_LIBDRM
	select BR2_PACKAGE_LIBEPOXY
	select BR2_PACKAGE_MESA3D
	select BR2_PACKAGE_QT6BASE
	select BR2_PACKAGE_QT6DECLARATIVE
	help
	  KDE plasma: kpipewire 6.8.3. GENERATED by scripts/kde-gen.py.
```
