## external/package/kf6-networkmanager-qt/Config.in
```kconfig
config BR2_PACKAGE_KF6_NETWORKMANAGER_QT
	bool "kf6-networkmanager-qt"
	select BR2_PACKAGE_KF6_EXTRA_CMAKE_MODULES
	select BR2_PACKAGE_QT6BASE
	select BR2_PACKAGE_QT6DECLARATIVE
	help
	  KDE frameworks: networkmanager-qt 6.32.0. GENERATED by scripts/kde-gen.py.
```

## external/package/kf6-prison/Config.in
```kconfig
config BR2_PACKAGE_KF6_PRISON
	bool "kf6-prison"
	select BR2_PACKAGE_KF6_EXTRA_CMAKE_MODULES
	select BR2_PACKAGE_LIBQRENCODE
	select BR2_PACKAGE_QT6BASE
	select BR2_PACKAGE_QT6DECLARATIVE
	select BR2_PACKAGE_QT6MULTIMEDIA
	select BR2_PACKAGE_ZXING_CPP
	help
	  KDE frameworks: prison 6.32.0. GENERATED by scripts/kde-gen.py.
```

## external/package/kf6-purpose/Config.in
```kconfig
config BR2_PACKAGE_KF6_PURPOSE
	bool "kf6-purpose"
	select BR2_PACKAGE_KF6_EXTRA_CMAKE_MODULES
	select BR2_PACKAGE_KF6_KCMUTILS
	select BR2_PACKAGE_KF6_KCONFIG
	select BR2_PACKAGE_KF6_KCOREADDONS
	select BR2_PACKAGE_KF6_KI18N
	select BR2_PACKAGE_KF6_KIO
	select BR2_PACKAGE_KF6_KIRIGAMI
	select BR2_PACKAGE_KF6_KITEMMODELS
	select BR2_PACKAGE_KF6_KSERVICE
	select BR2_PACKAGE_KF6_PRISON
	select BR2_PACKAGE_QT6BASE
	select BR2_PACKAGE_QT6DECLARATIVE
	help
	  KDE frameworks: purpose 6.32.0. GENERATED by scripts/kde-gen.py.
```

## external/package/kf6-qqc2-desktop-style/Config.in
```kconfig
config BR2_PACKAGE_KF6_QQC2_DESKTOP_STYLE
	bool "kf6-qqc2-desktop-style"
	select BR2_PACKAGE_KF6_EXTRA_CMAKE_MODULES
	select BR2_PACKAGE_KF6_KCOLORSCHEME
	select BR2_PACKAGE_KF6_KICONTHEMES
	select BR2_PACKAGE_KF6_KIRIGAMI
	select BR2_PACKAGE_KF6_SONNET
	select BR2_PACKAGE_QT6BASE
	select BR2_PACKAGE_QT6DECLARATIVE
	select BR2_PACKAGE_XLIB_LIBX11
	help
	  KDE frameworks: qqc2-desktop-style 6.32.0. GENERATED by scripts/kde-gen.py.
```

## external/package/kf6-solid/Config.in
```kconfig
config BR2_PACKAGE_KF6_SOLID
	bool "kf6-solid"
	select BR2_PACKAGE_EUDEV
	select BR2_PACKAGE_KF6_EXTRA_CMAKE_MODULES
	select BR2_PACKAGE_QT6BASE
	select BR2_PACKAGE_UDEV
	select BR2_PACKAGE_UTIL_LINUX
	help
	  KDE frameworks: solid 6.32.0. GENERATED by scripts/kde-gen.py.
```

## external/package/kf6-sonnet/Config.in
```kconfig
config BR2_PACKAGE_KF6_SONNET
	bool "kf6-sonnet"
	select BR2_PACKAGE_KF6_EXTRA_CMAKE_MODULES
	select BR2_PACKAGE_QT6BASE
	select BR2_PACKAGE_QT6DECLARATIVE
	select BR2_PACKAGE_ZLIB
	help
	  KDE frameworks: sonnet 6.32.0. GENERATED by scripts/kde-gen.py.
```

## external/package/kf6-syndication/Config.in
```kconfig
config BR2_PACKAGE_KF6_SYNDICATION
	bool "kf6-syndication"
	select BR2_PACKAGE_KF6_EXTRA_CMAKE_MODULES
	select BR2_PACKAGE_KF6_KCODECS
	select BR2_PACKAGE_QT6BASE
	help
	  KDE frameworks: syndication 6.32.0. GENERATED by scripts/kde-gen.py.
```

## external/package/kf6-threadweaver/Config.in
```kconfig
config BR2_PACKAGE_KF6_THREADWEAVER
	bool "kf6-threadweaver"
	select BR2_PACKAGE_KF6_EXTRA_CMAKE_MODULES
	select BR2_PACKAGE_QT6BASE
	help
	  KDE frameworks: threadweaver 6.32.0. GENERATED by scripts/kde-gen.py.
```

## external/package/layer-shell-qt/Config.in
```kconfig
config BR2_PACKAGE_LAYER_SHELL_QT
	bool "layer-shell-qt"
	select BR2_PACKAGE_KF6_EXTRA_CMAKE_MODULES
	select BR2_PACKAGE_LIBXKBCOMMON
	select BR2_PACKAGE_QT6BASE
	select BR2_PACKAGE_QT6DECLARATIVE
	select BR2_PACKAGE_QT6WAYLAND
	select BR2_PACKAGE_WAYLAND
	select BR2_PACKAGE_WAYLAND_PROTOCOLS
	help
	  KDE plasma: layer-shell-qt 6.8.3. GENERATED by scripts/kde-gen.py.
```

## external/package/libdbusmenu-lxqt/Config.in
```kconfig
config BR2_PACKAGE_LIBDBUSMENU_LXQT
	bool "libdbusmenu-lxqt"
	select BR2_PACKAGE_QT6
	select BR2_PACKAGE_QT6BASE_GUI
	select BR2_PACKAGE_QT6BASE_WIDGETS
	select BR2_PACKAGE_QT6BASE_DBUS
	select BR2_PACKAGE_HOST_QT6TOOLS
	select BR2_PACKAGE_HOST_QT6TOOLS_LINGUIST_TOOLS
	help
	  libdbusmenu-lxqt: Qt implementation of the DBusMenu protocol
	  (menus of tray icons).

	  https://github.com/lxqt/libdbusmenu-lxqt
```

## external/package/libfm-qt/Config.in
```kconfig
config BR2_PACKAGE_LIBFM_QT
	bool "libfm-qt"
	select BR2_PACKAGE_LXQT_BUILD_TOOLS
	select BR2_PACKAGE_LXQT_MENU_DATA
	select BR2_PACKAGE_MENU_CACHE
	select BR2_PACKAGE_LIBGLIB2
	select BR2_PACKAGE_LIBEXIF
	select BR2_PACKAGE_LIBXCB
	select BR2_PACKAGE_QT6
	select BR2_PACKAGE_QT6BASE_GUI
	select BR2_PACKAGE_QT6BASE_WIDGETS
	select BR2_PACKAGE_QT6BASE_DBUS
	select BR2_PACKAGE_HOST_QT6TOOLS
	select BR2_PACKAGE_HOST_QT6TOOLS_LINGUIST_TOOLS
	help
	  libfm-qt: the file manager library of PCManFM-Qt and the LXQt
	  desktop.

	  https://github.com/lxqt/libfm-qt
```

## external/package/liblxqt/Config.in
```kconfig
config BR2_PACKAGE_LIBLXQT
	bool "liblxqt"
	select BR2_PACKAGE_LXQT_BUILD_TOOLS
	select BR2_PACKAGE_LIBQTXDG
	select BR2_PACKAGE_KF6_KWINDOWSYSTEM
	select BR2_PACKAGE_POLKIT_QT6
	select BR2_PACKAGE_XLIB_LIBX11
	select BR2_PACKAGE_XLIB_LIBXSCRNSAVER
	select BR2_PACKAGE_QT6
	select BR2_PACKAGE_QT6BASE_GUI
	select BR2_PACKAGE_QT6BASE_WIDGETS
	select BR2_PACKAGE_QT6BASE_DBUS
	select BR2_PACKAGE_HOST_QT6TOOLS
	select BR2_PACKAGE_HOST_QT6TOOLS_LINGUIST_TOOLS
	select BR2_PACKAGE_QT6BASE_XML
	help
	  liblxqt: core library of the LXQt desktop.

	  https://github.com/lxqt/liblxqt
```

## external/package/libqtxdg/Config.in
```kconfig
config BR2_PACKAGE_LIBQTXDG
	bool "libqtxdg"
	select BR2_PACKAGE_LXQT_BUILD_TOOLS
	select BR2_PACKAGE_QT6
	select BR2_PACKAGE_QT6BASE_GUI
	select BR2_PACKAGE_QT6BASE_WIDGETS
	select BR2_PACKAGE_QT6BASE_DBUS
	select BR2_PACKAGE_HOST_QT6TOOLS
	select BR2_PACKAGE_HOST_QT6TOOLS_LINGUIST_TOOLS
	select BR2_PACKAGE_QT6BASE_XML
	select BR2_PACKAGE_QT6SVG
	select BR2_PACKAGE_LIBGLIB2
	help
	  libqtxdg: Qt implementation of the freedesktop.org XDG
	  specifications (desktop entries, menus, icon themes, MIME).

	  https://github.com/lxqt/libqtxdg
```

## external/package/libsysstat/Config.in
```kconfig
config BR2_PACKAGE_LIBSYSSTAT
	bool "libsysstat"
	select BR2_PACKAGE_LXQT_BUILD_TOOLS
	select BR2_PACKAGE_QT6
	select BR2_PACKAGE_QT6BASE_GUI
	select BR2_PACKAGE_QT6BASE_WIDGETS
	select BR2_PACKAGE_QT6BASE_DBUS
	select BR2_PACKAGE_HOST_QT6TOOLS
	select BR2_PACKAGE_HOST_QT6TOOLS_LINGUIST_TOOLS
	help
	  libsysstat: system statistics (CPU, memory, network) for Qt.

	  https://github.com/lxqt/libsysstat
```

## external/package/libxcrypt-compat/Config.in
```kconfig
config BR2_PACKAGE_LIBXCRYPT_COMPAT
	bool "libxcrypt-compat (libcrypt.so.1)"
	depends on BR2_TOOLCHAIN_USES_GLIBC
	help
	  libxcrypt built with the glibc-compatible obsolete API, providing
	  libcrypt.so.1 with the GLIBC_2.x symbol versions that binaries
	  built against older glibc (e.g. RHEL/CentOS 7) link to. Only the
	  shared library is installed; Buildroot's libxcrypt provides the
	  development files and libcrypt.so.2.
```

## external/package/libxklavier/Config.in
```kconfig
config BR2_PACKAGE_LIBXKLAVIER
	bool "libxklavier"
	depends on BR2_PACKAGE_XORG7
	select BR2_PACKAGE_LIBGLIB2
	select BR2_PACKAGE_LIBXML2
	select BR2_PACKAGE_XLIB_LIBX11
	select BR2_PACKAGE_XLIB_LIBXKBFILE
	select BR2_PACKAGE_XLIB_LIBXI
	help
	  libxklavier: high-level API for X keyboard layouts.

	  https://www.freedesktop.org/wiki/Software/LibXklavier/
```

## external/package/lightdm-gtk-greeter/Config.in
```kconfig
config BR2_PACKAGE_LIGHTDM_GTK_GREETER
	bool "lightdm-gtk-greeter"
	depends on BR2_PACKAGE_LIGHTDM
	depends on BR2_PACKAGE_LIBGTK3_X11
	help
	  GTK login screen for LightDM.

	  https://github.com/Xubuntu/lightdm-gtk-greeter
```

## external/package/lightdm/Config.in
```kconfig
config BR2_PACKAGE_LIGHTDM
	bool "lightdm"
	depends on BR2_PACKAGE_XORG7
	depends on BR2_PACKAGE_LINUX_PAM
	select BR2_PACKAGE_LIBGLIB2
	select BR2_PACKAGE_LIBGCRYPT
	select BR2_PACKAGE_LIBXCB
	select BR2_PACKAGE_XLIB_LIBX11
	select BR2_PACKAGE_XLIB_LIBXDMCP
	select BR2_PACKAGE_LIBXKLAVIER
	select BR2_PACKAGE_DBUS
	help
	  LightDM: lightweight display manager (graphical login
	  screen). Needs a greeter, e.g. lightdm-gtk-greeter.

	  https://github.com/canonical/lightdm
```

## external/package/lxqt-archiver/Config.in
```kconfig
config BR2_PACKAGE_LXQT_ARCHIVER
	bool "lxqt-archiver"
	select BR2_PACKAGE_LIBFM_QT
	select BR2_PACKAGE_JSON_GLIB
	select BR2_PACKAGE_LIBGLIB2
	select BR2_PACKAGE_QT6
	select BR2_PACKAGE_QT6BASE_GUI
	select BR2_PACKAGE_QT6BASE_WIDGETS
	select BR2_PACKAGE_HOST_QT6TOOLS
	select BR2_PACKAGE_HOST_QT6TOOLS_LINGUIST_TOOLS
	help
	  LXQt archive manager: opens, creates and extracts archives
	  (zip, 7z, tar.gz/xz/bz2/zst, ...) with the command-line tools.

	  https://github.com/lxqt/lxqt-archiver
```

## external/package/lxqt-build-tools/Config.in
```kconfig
config BR2_PACKAGE_LXQT_BUILD_TOOLS
	bool "lxqt-build-tools"
	select BR2_PACKAGE_QT6
	help
	  LXQt build tools: CMake modules shared by the LXQt components.

	  https://github.com/lxqt/lxqt-build-tools
```

## external/package/lxqt-config/Config.in
```kconfig
config BR2_PACKAGE_LXQT_CONFIG
	bool "lxqt-config"
	select BR2_PACKAGE_LIBLXQT
	select BR2_PACKAGE_LXQT_MENU_DATA
	select BR2_PACKAGE_QT6SVG
	select BR2_PACKAGE_LIBXCB
	select BR2_PACKAGE_XLIB_LIBXCURSOR
	select BR2_PACKAGE_XLIB_LIBXI
	select BR2_PACKAGE_XLIB_LIBXFIXES
	select BR2_PACKAGE_XDRIVER_XF86_INPUT_LIBINPUT
	select BR2_PACKAGE_ZLIB
	select BR2_PACKAGE_QT6BASE_XML
	select BR2_PACKAGE_QT6
	select BR2_PACKAGE_QT6BASE_GUI
	select BR2_PACKAGE_QT6BASE_WIDGETS
	select BR2_PACKAGE_QT6BASE_DBUS
	select BR2_PACKAGE_HOST_QT6TOOLS
	select BR2_PACKAGE_HOST_QT6TOOLS_LINGUIST_TOOLS
	help
	  LXQt configuration center: appearance, input, file
	  associations, locale, brightness.

	  https://github.com/lxqt/lxqt-config
```

## external/package/lxqt-globalkeys/Config.in
```kconfig
config BR2_PACKAGE_LXQT_GLOBALKEYS
	bool "lxqt-globalkeys"
	select BR2_PACKAGE_LIBLXQT
	select BR2_PACKAGE_QT6
	select BR2_PACKAGE_QT6BASE_GUI
	select BR2_PACKAGE_QT6BASE_WIDGETS
	select BR2_PACKAGE_QT6BASE_DBUS
	select BR2_PACKAGE_HOST_QT6TOOLS
	select BR2_PACKAGE_HOST_QT6TOOLS_LINGUIST_TOOLS
	help
	  LXQt global keyboard shortcuts daemon and library.

	  https://github.com/lxqt/lxqt-globalkeys
```

## external/package/lxqt-menu-data/Config.in
```kconfig
config BR2_PACKAGE_LXQT_MENU_DATA
	bool "lxqt-menu-data"
	select BR2_PACKAGE_LXQT_BUILD_TOOLS
	select BR2_PACKAGE_QT6
	select BR2_PACKAGE_QT6BASE_GUI
	select BR2_PACKAGE_QT6BASE_WIDGETS
	select BR2_PACKAGE_QT6BASE_DBUS
	select BR2_PACKAGE_HOST_QT6TOOLS
	select BR2_PACKAGE_HOST_QT6TOOLS_LINGUIST_TOOLS
	help
	  LXQt menu data: the freedesktop.org application menu files.

	  https://github.com/lxqt/lxqt-menu-data
```

## external/package/lxqt-notificationd/Config.in
```kconfig
config BR2_PACKAGE_LXQT_NOTIFICATIOND
	bool "lxqt-notificationd"
	select BR2_PACKAGE_LIBLXQT
	select BR2_PACKAGE_KF6_KWINDOWSYSTEM
	select BR2_PACKAGE_LAYER_SHELL_QT
	select BR2_PACKAGE_QT6
	select BR2_PACKAGE_QT6BASE_GUI
	select BR2_PACKAGE_QT6BASE_WIDGETS
	select BR2_PACKAGE_QT6BASE_DBUS
	select BR2_PACKAGE_HOST_QT6TOOLS
	select BR2_PACKAGE_HOST_QT6TOOLS_LINGUIST_TOOLS
	help
	  LXQt notification daemon.

	  https://github.com/lxqt/lxqt-notificationd
```

## external/package/lxqt-panel/Config.in
```kconfig
config BR2_PACKAGE_LXQT_PANEL
	bool "lxqt-panel"
	select BR2_PACKAGE_LIBLXQT
	select BR2_PACKAGE_LXQT_GLOBALKEYS
	select BR2_PACKAGE_LXQT_MENU_DATA
	select BR2_PACKAGE_LIBDBUSMENU_LXQT
	select BR2_PACKAGE_LIBSYSSTAT
	select BR2_PACKAGE_KF6_KWINDOWSYSTEM
	select BR2_PACKAGE_KF6_SOLID
	select BR2_PACKAGE_LAYER_SHELL_QT
	select BR2_PACKAGE_QT6WAYLAND
	select BR2_PACKAGE_LIBXKBCOMMON
	select BR2_PACKAGE_XLIB_LIBXTST
	select BR2_PACKAGE_LIBXCB
	select BR2_PACKAGE_ALSA_LIB
	select BR2_PACKAGE_QT6BASE_CONCURRENT
	select BR2_PACKAGE_QT6BASE_XML
	select BR2_PACKAGE_QT6
	select BR2_PACKAGE_QT6BASE_GUI
	select BR2_PACKAGE_QT6BASE_WIDGETS
	select BR2_PACKAGE_QT6BASE_DBUS
	select BR2_PACKAGE_HOST_QT6TOOLS
	select BR2_PACKAGE_HOST_QT6TOOLS_LINGUIST_TOOLS
	help
	  LXQt panel: task bar, application menu, tray, clock, volume and
	  more plugins.

	  https://github.com/lxqt/lxqt-panel
```
