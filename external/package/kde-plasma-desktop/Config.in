## external/package/kde-plasma-desktop/Config.in
```kconfig
config BR2_PACKAGE_KDE_PLASMA_DESKTOP
	bool "kde-plasma-desktop"
	select BR2_PACKAGE_EUDEV
	select BR2_PACKAGE_KDE_BREEZE
	select BR2_PACKAGE_KDE_KACTIVITYMANAGERD
	select BR2_PACKAGE_KDE_KIO_EXTRAS
	select BR2_PACKAGE_KDE_KIRIGAMI_ADDONS
	select BR2_PACKAGE_KDE_LIBKSYSGUARD
	select BR2_PACKAGE_KDE_LIBPLASMA
	select BR2_PACKAGE_KDE_PLASMA_ACTIVITIES
	select BR2_PACKAGE_KDE_PLASMA_ACTIVITIES_STATS
	select BR2_PACKAGE_KDE_PLASMA_INTEGRATION
	select BR2_PACKAGE_KDE_PLASMA_PA
	select BR2_PACKAGE_KDE_PLASMA_WORKSPACE
	select BR2_PACKAGE_KDE_POWERDEVIL
	select BR2_PACKAGE_KDE_SYSTEMSETTINGS
	select BR2_PACKAGE_KF6_ATTICA
	select BR2_PACKAGE_KF6_BALOO
	select BR2_PACKAGE_KF6_EXTRA_CMAKE_MODULES
	select BR2_PACKAGE_KF6_KAUTH
	select BR2_PACKAGE_KF6_KCMUTILS
	select BR2_PACKAGE_KF6_KCODECS
	select BR2_PACKAGE_KF6_KCOMPLETION
	select BR2_PACKAGE_KF6_KCONFIG
	select BR2_PACKAGE_KF6_KCONFIGWIDGETS
	select BR2_PACKAGE_KF6_KCOREADDONS
	select BR2_PACKAGE_KF6_KCRASH
	select BR2_PACKAGE_KF6_KDBUSADDONS
	select BR2_PACKAGE_KF6_KDED
	select BR2_PACKAGE_KF6_KFILEMETADATA
	select BR2_PACKAGE_KF6_KGLOBALACCEL
	select BR2_PACKAGE_KF6_KGUIADDONS
	select BR2_PACKAGE_KF6_KI18N
	select BR2_PACKAGE_KF6_KICONTHEMES
	select BR2_PACKAGE_KF6_KIO
	select BR2_PACKAGE_KF6_KITEMMODELS
	select BR2_PACKAGE_KF6_KITEMVIEWS
	select BR2_PACKAGE_KF6_KJOBWIDGETS
	select BR2_PACKAGE_KF6_KNEWSTUFF
	select BR2_PACKAGE_KF6_KNOTIFICATIONS
	select BR2_PACKAGE_KF6_KNOTIFYCONFIG
	select BR2_PACKAGE_KF6_KPACKAGE
	select BR2_PACKAGE_KF6_KPARTS
	select BR2_PACKAGE_KF6_KRUNNER
	select BR2_PACKAGE_KF6_KSERVICE
	select BR2_PACKAGE_KF6_KTEXTWIDGETS
	select BR2_PACKAGE_KF6_KUNITCONVERSION
	select BR2_PACKAGE_KF6_KWIDGETSADDONS
	select BR2_PACKAGE_KF6_KWINDOWSYSTEM
	select BR2_PACKAGE_KF6_KXMLGUI
	select BR2_PACKAGE_KF6_QQC2_DESKTOP_STYLE
	select BR2_PACKAGE_KF6_SOLID
	select BR2_PACKAGE_KF6_SONNET
	select BR2_PACKAGE_LIBCANBERRA
	select BR2_PACKAGE_LIBGLIB2
	select BR2_PACKAGE_LIBXCB
	select BR2_PACKAGE_POLKIT_QT6
	select BR2_PACKAGE_QT6BASE
	select BR2_PACKAGE_QT6CORE5COMPAT
	select BR2_PACKAGE_QT6DECLARATIVE
	select BR2_PACKAGE_QT6SHADERTOOLS
	select BR2_PACKAGE_QT6SVG
	select BR2_PACKAGE_QT6WAYLAND
	select BR2_PACKAGE_WAYLAND
	select BR2_PACKAGE_WAYLAND_PROTOCOLS
	select BR2_PACKAGE_XCB_UTIL_CURSOR
	select BR2_PACKAGE_XCB_UTIL_IMAGE
	select BR2_PACKAGE_XCB_UTIL_KEYSYMS
	select BR2_PACKAGE_XCB_UTIL_WM
	select BR2_PACKAGE_XLIB_LIBX11
	help
	  KDE plasma: plasma-desktop 6.8.3. GENERATED by scripts/kde-gen.py.
```

## external/package/kde-plasma-disks/Config.in
```kconfig
config BR2_PACKAGE_KDE_PLASMA_DISKS
	bool "kde-plasma-disks"
	select BR2_PACKAGE_KF6_EXTRA_CMAKE_MODULES
	select BR2_PACKAGE_KF6_KAUTH
	select BR2_PACKAGE_KF6_KCMUTILS
	select BR2_PACKAGE_KF6_KCODECS
	select BR2_PACKAGE_KF6_KCONFIG
	select BR2_PACKAGE_KF6_KCOREADDONS
	select BR2_PACKAGE_KF6_KDBUSADDONS
	select BR2_PACKAGE_KF6_KDECLARATIVE
	select BR2_PACKAGE_KF6_KI18N
	select BR2_PACKAGE_KF6_KIO
	select BR2_PACKAGE_KF6_KNOTIFICATIONS
	select BR2_PACKAGE_KF6_KSERVICE
	select BR2_PACKAGE_KF6_KWIDGETSADDONS
	select BR2_PACKAGE_KF6_KWINDOWSYSTEM
	select BR2_PACKAGE_KF6_SOLID
	select BR2_PACKAGE_QT6BASE
	select BR2_PACKAGE_QT6DECLARATIVE
	help
	  KDE plasma: plasma-disks 6.8.3. GENERATED by scripts/kde-gen.py.
```

## external/package/kde-plasma-integration/Config.in
```kconfig
config BR2_PACKAGE_KDE_PLASMA_INTEGRATION
	bool "kde-plasma-integration"
	select BR2_PACKAGE_KDE_BREEZE
	select BR2_PACKAGE_KDE_PLASMA_WAYLAND_PROTOCOLS
	select BR2_PACKAGE_KF6_EXTRA_CMAKE_MODULES
	select BR2_PACKAGE_KF6_KCOLORSCHEME
	select BR2_PACKAGE_KF6_KCONFIG
	select BR2_PACKAGE_KF6_KCOREADDONS
	select BR2_PACKAGE_KF6_KGUIADDONS
	select BR2_PACKAGE_KF6_KI18N
	select BR2_PACKAGE_KF6_KICONTHEMES
	select BR2_PACKAGE_KF6_KIO
	select BR2_PACKAGE_KF6_KJOBWIDGETS
	select BR2_PACKAGE_KF6_KNOTIFICATIONS
	select BR2_PACKAGE_KF6_KSERVICE
	select BR2_PACKAGE_KF6_KSTATUSNOTIFIERITEM
	select BR2_PACKAGE_KF6_KWIDGETSADDONS
	select BR2_PACKAGE_KF6_KWINDOWSYSTEM
	select BR2_PACKAGE_KF6_KXMLGUI
	select BR2_PACKAGE_LIBXCB
	select BR2_PACKAGE_QT6BASE
	select BR2_PACKAGE_QT6DECLARATIVE
	select BR2_PACKAGE_QT6WAYLAND
	select BR2_PACKAGE_WAYLAND
	select BR2_PACKAGE_XCB_UTIL_CURSOR
	select BR2_PACKAGE_XCB_UTIL_IMAGE
	select BR2_PACKAGE_XCB_UTIL_KEYSYMS
	select BR2_PACKAGE_XCB_UTIL_WM
	select BR2_PACKAGE_XLIB_LIBX11
	help
	  KDE plasma: plasma-integration 6.8.3. GENERATED by scripts/kde-gen.py.
```

## external/package/kde-plasma-nm/Config.in
```kconfig
config BR2_PACKAGE_KDE_PLASMA_NM
	bool "kde-plasma-nm"
	select BR2_PACKAGE_KDE_LIBPLASMA
	select BR2_PACKAGE_KDE_QCORO
	select BR2_PACKAGE_KF6_EXTRA_CMAKE_MODULES
	select BR2_PACKAGE_KF6_KAUTH
	select BR2_PACKAGE_KF6_KCMUTILS
	select BR2_PACKAGE_KF6_KCODECS
	select BR2_PACKAGE_KF6_KCOMPLETION
	select BR2_PACKAGE_KF6_KCONFIG
	select BR2_PACKAGE_KF6_KCONFIGWIDGETS
	select BR2_PACKAGE_KF6_KCOREADDONS
	select BR2_PACKAGE_KF6_KDBUSADDONS
	select BR2_PACKAGE_KF6_KDECLARATIVE
	select BR2_PACKAGE_KF6_KI18N
	select BR2_PACKAGE_KF6_KIO
	select BR2_PACKAGE_KF6_KJOBWIDGETS
	select BR2_PACKAGE_KF6_KNOTIFICATIONS
	select BR2_PACKAGE_KF6_KPACKAGE
	select BR2_PACKAGE_KF6_KQUICKCHARTS
	select BR2_PACKAGE_KF6_KSERVICE
	select BR2_PACKAGE_KF6_KSVG
	select BR2_PACKAGE_KF6_KWALLET
	select BR2_PACKAGE_KF6_KWIDGETSADDONS
	select BR2_PACKAGE_KF6_KWINDOWSYSTEM
	select BR2_PACKAGE_KF6_MODEMMANAGER_QT
	select BR2_PACKAGE_KF6_NETWORKMANAGER_QT
	select BR2_PACKAGE_KF6_PRISON
	select BR2_PACKAGE_KF6_SOLID
	select BR2_PACKAGE_OPENSSL
	select BR2_PACKAGE_QT6BASE
	select BR2_PACKAGE_QT6DECLARATIVE
	help
	  KDE plasma: plasma-nm 6.8.3. GENERATED by scripts/kde-gen.py.
```

## external/package/kde-plasma-pa/Config.in
```kconfig
config BR2_PACKAGE_KDE_PLASMA_PA
	bool "kde-plasma-pa"
	select BR2_PACKAGE_KDE_KIRIGAMI_ADDONS
	select BR2_PACKAGE_KDE_LIBPLASMA
	select BR2_PACKAGE_KDE_PLASMA_WORKSPACE
	select BR2_PACKAGE_KDE_PULSEAUDIO_QT
	select BR2_PACKAGE_KF6_EXTRA_CMAKE_MODULES
	select BR2_PACKAGE_KF6_KCMUTILS
	select BR2_PACKAGE_KF6_KCONFIG
	select BR2_PACKAGE_KF6_KCOREADDONS
	select BR2_PACKAGE_KF6_KDECLARATIVE
	select BR2_PACKAGE_KF6_KGLOBALACCEL
	select BR2_PACKAGE_KF6_KI18N
	select BR2_PACKAGE_KF6_KITEMMODELS
	select BR2_PACKAGE_KF6_KPACKAGE
	select BR2_PACKAGE_KF6_KSTATUSNOTIFIERITEM
	select BR2_PACKAGE_KF6_KSVG
	select BR2_PACKAGE_LIBCANBERRA
	select BR2_PACKAGE_QT6BASE
	select BR2_PACKAGE_QT6DECLARATIVE
	help
	  KDE plasma: plasma-pa 6.8.3. GENERATED by scripts/kde-gen.py.
```

## external/package/kde-plasma-systemmonitor/Config.in
```kconfig
config BR2_PACKAGE_KDE_PLASMA_SYSTEMMONITOR
	bool "kde-plasma-systemmonitor"
	select BR2_PACKAGE_KDE_KIRIGAMI_ADDONS
	select BR2_PACKAGE_KDE_LIBKSYSGUARD
	select BR2_PACKAGE_KF6_ATTICA
	select BR2_PACKAGE_KF6_EXTRA_CMAKE_MODULES
	select BR2_PACKAGE_KF6_KCONFIG
	select BR2_PACKAGE_KF6_KCOREADDONS
	select BR2_PACKAGE_KF6_KDBUSADDONS
	select BR2_PACKAGE_KF6_KDECLARATIVE
	select BR2_PACKAGE_KF6_KGLOBALACCEL
	select BR2_PACKAGE_KF6_KI18N
	select BR2_PACKAGE_KF6_KICONTHEMES
	select BR2_PACKAGE_KF6_KIO
	select BR2_PACKAGE_KF6_KITEMMODELS
	select BR2_PACKAGE_KF6_KNEWSTUFF
	select BR2_PACKAGE_KF6_KPACKAGE
	select BR2_PACKAGE_KF6_KSERVICE
	select BR2_PACKAGE_KF6_KWINDOWSYSTEM
	select BR2_PACKAGE_QT6BASE
	select BR2_PACKAGE_QT6DECLARATIVE
	help
	  KDE plasma: plasma-systemmonitor 6.8.3. GENERATED by scripts/kde-gen.py.
```

## external/package/kde-plasma-wayland-protocols/Config.in
```kconfig
config BR2_PACKAGE_KDE_PLASMA_WAYLAND_PROTOCOLS
	bool "kde-plasma-wayland-protocols"
	select BR2_PACKAGE_KF6_EXTRA_CMAKE_MODULES
	select BR2_PACKAGE_QT6BASE
	select BR2_PACKAGE_WAYLAND
	help
	  KDE other: plasma-wayland-protocols 1.23.0. GENERATED by scripts/kde-gen.py.
```

## external/package/kde-plasma-welcome/Config.in
```kconfig
config BR2_PACKAGE_KDE_PLASMA_WELCOME
	bool "kde-plasma-welcome"
	select BR2_PACKAGE_KDE_KIRIGAMI_ADDONS
	select BR2_PACKAGE_KDE_LIBPLASMA
	select BR2_PACKAGE_KDE_MILOU
	select BR2_PACKAGE_KF6_EXTRA_CMAKE_MODULES
	select BR2_PACKAGE_KF6_KCMUTILS
	select BR2_PACKAGE_KF6_KCOREADDONS
	select BR2_PACKAGE_KF6_KDBUSADDONS
	select BR2_PACKAGE_KF6_KI18N
	select BR2_PACKAGE_KF6_KIO
	select BR2_PACKAGE_KF6_KIRIGAMI
	select BR2_PACKAGE_KF6_KJOBWIDGETS
	select BR2_PACKAGE_KF6_KNEWSTUFF
	select BR2_PACKAGE_KF6_KNOTIFICATIONS
	select BR2_PACKAGE_KF6_KSVG
	select BR2_PACKAGE_KF6_KWINDOWSYSTEM
	select BR2_PACKAGE_QT6BASE
	select BR2_PACKAGE_QT6DECLARATIVE
	select BR2_PACKAGE_QT6SVG
	help
	  KDE plasma: plasma-welcome 6.8.3. GENERATED by scripts/kde-gen.py.
```

## external/package/kde-plasma-workspace-wallpapers/Config.in
```kconfig
config BR2_PACKAGE_KDE_PLASMA_WORKSPACE_WALLPAPERS
	bool "kde-plasma-workspace-wallpapers"
	select BR2_PACKAGE_KF6_EXTRA_CMAKE_MODULES
	select BR2_PACKAGE_QT6BASE
	help
	  KDE plasma: plasma-workspace-wallpapers 6.8.3. GENERATED by scripts/kde-gen.py.
```

## external/package/kde-plasma-workspace/Config.in
```kconfig
config BR2_PACKAGE_KDE_PLASMA_WORKSPACE
	bool "kde-plasma-workspace"
	select BR2_PACKAGE_EUDEV
	select BR2_PACKAGE_FONTCONFIG
	select BR2_PACKAGE_FREETYPE
	select BR2_PACKAGE_ICU
	select BR2_PACKAGE_KDE_ACCOUNTSSERVICE
	select BR2_PACKAGE_KDE_APPSTREAM
	select BR2_PACKAGE_KDE_KACTIVITYMANAGERD
	select BR2_PACKAGE_KDE_KGLOBALACCELD
	select BR2_PACKAGE_KDE_KIO_EXTRAS
	select BR2_PACKAGE_KDE_KIRIGAMI_ADDONS
	select BR2_PACKAGE_KDE_KNIGHTTIME
	select BR2_PACKAGE_KDE_KSCREENLOCKER
	select BR2_PACKAGE_KDE_KWAYLAND
	select BR2_PACKAGE_KDE_KWIN
	select BR2_PACKAGE_KDE_LIBKEXIV2
	select BR2_PACKAGE_KDE_LIBKSCREEN
	select BR2_PACKAGE_KDE_LIBKSYSGUARD
	select BR2_PACKAGE_KDE_LIBPLASMA
	select BR2_PACKAGE_KDE_MILOU
	select BR2_PACKAGE_KDE_PLASMA_ACTIVITIES
	select BR2_PACKAGE_KDE_PLASMA_ACTIVITIES_STATS
	select BR2_PACKAGE_KDE_PLASMA_WAYLAND_PROTOCOLS
	select BR2_PACKAGE_KDE_QCORO
	select BR2_PACKAGE_KF6_ATTICA
	select BR2_PACKAGE_KF6_BALOO
	select BR2_PACKAGE_KF6_EXTRA_CMAKE_MODULES
	select BR2_PACKAGE_KF6_KAUTH
	select BR2_PACKAGE_KF6_KBOOKMARKS
	select BR2_PACKAGE_KF6_KCMUTILS
	select BR2_PACKAGE_KF6_KCODECS
	select BR2_PACKAGE_KF6_KCOLORSCHEME
	select BR2_PACKAGE_KF6_KCOMPLETION
	select BR2_PACKAGE_KF6_KCONFIG
	select BR2_PACKAGE_KF6_KCONFIGWIDGETS
	select BR2_PACKAGE_KF6_KCOREADDONS
	select BR2_PACKAGE_KF6_KCRASH
	select BR2_PACKAGE_KF6_KDBUSADDONS
	select BR2_PACKAGE_KF6_KDECLARATIVE
	select BR2_PACKAGE_KF6_KDED
	select BR2_PACKAGE_KF6_KFILEMETADATA
	select BR2_PACKAGE_KF6_KGLOBALACCEL
	select BR2_PACKAGE_KF6_KGUIADDONS
	select BR2_PACKAGE_KF6_KHOLIDAYS
	select BR2_PACKAGE_KF6_KI18N
	select BR2_PACKAGE_KF6_KICONTHEMES
	select BR2_PACKAGE_KF6_KIO
	select BR2_PACKAGE_KF6_KITEMMODELS
	select BR2_PACKAGE_KF6_KITEMVIEWS
	select BR2_PACKAGE_KF6_KJOBWIDGETS
	select BR2_PACKAGE_KF6_KNEWSTUFF
	select BR2_PACKAGE_KF6_KNOTIFICATIONS
	select BR2_PACKAGE_KF6_KPACKAGE
	select BR2_PACKAGE_KF6_KPARTS
	select BR2_PACKAGE_KF6_KQUICKCHARTS
	select BR2_PACKAGE_KF6_KRUNNER
	select BR2_PACKAGE_KF6_KSERVICE
	select BR2_PACKAGE_KF6_KSTATUSNOTIFIERITEM
	select BR2_PACKAGE_KF6_KTEXTEDITOR
	select BR2_PACKAGE_KF6_KTEXTWIDGETS
	select BR2_PACKAGE_KF6_KWALLET
	select BR2_PACKAGE_KF6_KWIDGETSADDONS
	select BR2_PACKAGE_KF6_KWINDOWSYSTEM
	select BR2_PACKAGE_KF6_KXMLGUI
	select BR2_PACKAGE_KF6_PRISON
	select BR2_PACKAGE_KF6_QQC2_DESKTOP_STYLE
	select BR2_PACKAGE_KF6_SOLID
	select BR2_PACKAGE_KF6_SONNET
	select BR2_PACKAGE_LAYER_SHELL_QT
	select BR2_PACKAGE_LIBCANBERRA
	select BR2_PACKAGE_LIBXCB
	select BR2_PACKAGE_POLKIT_QT6
	select BR2_PACKAGE_QT6BASE
	select BR2_PACKAGE_QT6DECLARATIVE
	select BR2_PACKAGE_QT6SHADERTOOLS
	select BR2_PACKAGE_QT6SVG
	select BR2_PACKAGE_QT6WAYLAND
	select BR2_PACKAGE_WAYLAND
	select BR2_PACKAGE_XCB_UTIL_CURSOR
	select BR2_PACKAGE_XCB_UTIL_IMAGE
	select BR2_PACKAGE_XCB_UTIL_KEYSYMS
	select BR2_PACKAGE_XCB_UTIL_WM
	select BR2_PACKAGE_XLIB_LIBX11
	select BR2_PACKAGE_ZLIB
	help
	  KDE plasma: plasma-workspace 6.8.3. GENERATED by scripts/kde-gen.py.
```

## external/package/kde-polkit-kde-agent-1/Config.in
```kconfig
config BR2_PACKAGE_KDE_POLKIT_KDE_AGENT_1
	bool "kde-polkit-kde-agent-1"
	select BR2_PACKAGE_KF6_EXTRA_CMAKE_MODULES
	select BR2_PACKAGE_KF6_KCOREADDONS
	select BR2_PACKAGE_KF6_KCRASH
	select BR2_PACKAGE_KF6_KDBUSADDONS
	select BR2_PACKAGE_KF6_KI18N
	select BR2_PACKAGE_KF6_KNOTIFICATIONS
	select BR2_PACKAGE_KF6_KWINDOWSYSTEM
	select BR2_PACKAGE_POLKIT_QT6
	select BR2_PACKAGE_QT6BASE
	select BR2_PACKAGE_QT6DECLARATIVE
	help
	  KDE plasma: polkit-kde-agent-1 6.8.3. GENERATED by scripts/kde-gen.py.
```

## external/package/kde-powerdevil/Config.in
```kconfig
config BR2_PACKAGE_KDE_POWERDEVIL
	bool "kde-powerdevil"
	select BR2_PACKAGE_EUDEV
	select BR2_PACKAGE_KDE_LIBKSCREEN
	select BR2_PACKAGE_KDE_PLASMA_ACTIVITIES
	select BR2_PACKAGE_KDE_PLASMA_WAYLAND_PROTOCOLS
	select BR2_PACKAGE_KDE_PLASMA_WORKSPACE
	select BR2_PACKAGE_KDE_QCORO
	select BR2_PACKAGE_KF6_EXTRA_CMAKE_MODULES
	select BR2_PACKAGE_KF6_KAUTH
	select BR2_PACKAGE_KF6_KCMUTILS
	select BR2_PACKAGE_KF6_KCODECS
	select BR2_PACKAGE_KF6_KCONFIG
	select BR2_PACKAGE_KF6_KCONFIGWIDGETS
	select BR2_PACKAGE_KF6_KCOREADDONS
	select BR2_PACKAGE_KF6_KCRASH
	select BR2_PACKAGE_KF6_KDBUSADDONS
	select BR2_PACKAGE_KF6_KGLOBALACCEL
	select BR2_PACKAGE_KF6_KI18N
	select BR2_PACKAGE_KF6_KIDLETIME
	select BR2_PACKAGE_KF6_KIO
	select BR2_PACKAGE_KF6_KJOBWIDGETS
	select BR2_PACKAGE_KF6_KNOTIFICATIONS
	select BR2_PACKAGE_KF6_KSERVICE
	select BR2_PACKAGE_KF6_KWINDOWSYSTEM
	select BR2_PACKAGE_KF6_KXMLGUI
	select BR2_PACKAGE_KF6_SOLID
	select BR2_PACKAGE_QT6BASE
	select BR2_PACKAGE_QT6WAYLAND
	select BR2_PACKAGE_WAYLAND
	help
	  KDE plasma: powerdevil 6.8.3. GENERATED by scripts/kde-gen.py.
```

## external/package/kde-pulseaudio-qt/Config.in
```kconfig
config BR2_PACKAGE_KDE_PULSEAUDIO_QT
	bool "kde-pulseaudio-qt"
	select BR2_PACKAGE_KF6_EXTRA_CMAKE_MODULES
	select BR2_PACKAGE_QT6BASE
	select BR2_PACKAGE_QT6DECLARATIVE
	help
	  KDE other: pulseaudio-qt 1.9.0. GENERATED by scripts/kde-gen.py.
```

## external/package/kde-qca/Config.in
```kconfig
config BR2_PACKAGE_KDE_QCA
	bool "kde-qca"
	select BR2_PACKAGE_KF6_EXTRA_CMAKE_MODULES
	select BR2_PACKAGE_OPENSSL
	select BR2_PACKAGE_QT6BASE
	select BR2_PACKAGE_QT6CORE5COMPAT
	help
	  KDE other: qca 2.3.12. GENERATED by scripts/kde-gen.py.
```

## external/package/kde-qcoro/Config.in
```kconfig
config BR2_PACKAGE_KDE_QCORO
	bool "kde-qcoro"
	select BR2_PACKAGE_QT6DECLARATIVE
	select BR2_PACKAGE_QT6DECLARATIVE_QUICK
	help
	  QCoro 0.13: C++20 coroutines for Qt.
```

## external/package/kde-qqc2-breeze-style/Config.in
```kconfig
config BR2_PACKAGE_KDE_QQC2_BREEZE_STYLE
	bool "kde-qqc2-breeze-style"
	select BR2_PACKAGE_KF6_EXTRA_CMAKE_MODULES
	select BR2_PACKAGE_KF6_KCODECS
	select BR2_PACKAGE_KF6_KCOLORSCHEME
	select BR2_PACKAGE_KF6_KCONFIG
	select BR2_PACKAGE_KF6_KGUIADDONS
	select BR2_PACKAGE_KF6_KICONTHEMES
	select BR2_PACKAGE_KF6_KIRIGAMI
	select BR2_PACKAGE_QT6BASE
	select BR2_PACKAGE_QT6DECLARATIVE
	select BR2_PACKAGE_XLIB_LIBX11
	help
	  KDE plasma: qqc2-breeze-style 6.8.3. GENERATED by scripts/kde-gen.py.
```

## external/package/kde-sddm-kcm/Config.in
```kconfig
config BR2_PACKAGE_KDE_SDDM_KCM
	bool "kde-sddm-kcm"
	select BR2_PACKAGE_KF6_EXTRA_CMAKE_MODULES
	select BR2_PACKAGE_KF6_KARCHIVE
	select BR2_PACKAGE_KF6_KAUTH
	select BR2_PACKAGE_KF6_KCMUTILS
	select BR2_PACKAGE_KF6_KCOREADDONS
	select BR2_PACKAGE_KF6_KI18N
	select BR2_PACKAGE_KF6_KIO
	select BR2_PACKAGE_KF6_KNEWSTUFF
	select BR2_PACKAGE_KF6_KSERVICE
	select BR2_PACKAGE_QT6BASE
	select BR2_PACKAGE_QT6DECLARATIVE
	help
	  KDE plasma: sddm-kcm 6.8.3. GENERATED by scripts/kde-gen.py.
```

## external/package/kde-sddm/Config.in
```kconfig
config BR2_PACKAGE_KDE_SDDM
	bool "kde-sddm"
	select BR2_PACKAGE_KDE_ELOGIND
	select BR2_PACKAGE_LINUX_PAM
	select BR2_PACKAGE_QT6DECLARATIVE
	select BR2_PACKAGE_QT6DECLARATIVE_QUICK
	select BR2_PACKAGE_QT6BASE_TEST
	select BR2_PACKAGE_LIBXKBCOMMON
	help
	  SDDM 0.21, the login screen of the KDE edition.
```
