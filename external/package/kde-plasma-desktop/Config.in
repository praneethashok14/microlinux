## external/package/kde-spectacle/Config.in
```kconfig
config BR2_PACKAGE_KDE_SPECTACLE
	bool "kde-spectacle"
	select BR2_PACKAGE_KDE_KPIPEWIRE
	select BR2_PACKAGE_KDE_KQUICKIMAGEEDITOR
	select BR2_PACKAGE_KDE_PLASMA_WAYLAND_PROTOCOLS
	select BR2_PACKAGE_KF6_EXTRA_CMAKE_MODULES
	select BR2_PACKAGE_KF6_KCONFIG
	select BR2_PACKAGE_KF6_KCOREADDONS
	select BR2_PACKAGE_KF6_KCRASH
	select BR2_PACKAGE_KF6_KDBUSADDONS
	select BR2_PACKAGE_KF6_KGLOBALACCEL
	select BR2_PACKAGE_KF6_KGUIADDONS
	select BR2_PACKAGE_KF6_KI18N
	select BR2_PACKAGE_KF6_KIO
	select BR2_PACKAGE_KF6_KIRIGAMI
	select BR2_PACKAGE_KF6_KNOTIFICATIONS
	select BR2_PACKAGE_KF6_KSTATUSNOTIFIERITEM
	select BR2_PACKAGE_KF6_KWIDGETSADDONS
	select BR2_PACKAGE_KF6_KWINDOWSYSTEM
	select BR2_PACKAGE_KF6_KXMLGUI
	select BR2_PACKAGE_KF6_PRISON
	select BR2_PACKAGE_KF6_PURPOSE
	select BR2_PACKAGE_LAYER_SHELL_QT
	select BR2_PACKAGE_LIBXCB
	select BR2_PACKAGE_QT6BASE
	select BR2_PACKAGE_QT6DECLARATIVE
	select BR2_PACKAGE_QT6MULTIMEDIA
	select BR2_PACKAGE_QT6WAYLAND
	select BR2_PACKAGE_WAYLAND
	select BR2_PACKAGE_XCB_UTIL_CURSOR
	select BR2_PACKAGE_XCB_UTIL_IMAGE
	select BR2_PACKAGE_XCB_UTIL_KEYSYMS
	select BR2_PACKAGE_XCB_UTIL_WM
	help
	  KDE plasma: spectacle 6.8.3. GENERATED by scripts/kde-gen.py.
```

## external/package/kde-sweeper/Config.in
```kconfig
config BR2_PACKAGE_KDE_SWEEPER
	bool "kde-sweeper"
	select BR2_PACKAGE_KDE_PLASMA_ACTIVITIES_STATS
	select BR2_PACKAGE_KF6_EXTRA_CMAKE_MODULES
	select BR2_PACKAGE_KF6_KBOOKMARKS
	select BR2_PACKAGE_KF6_KCONFIG
	select BR2_PACKAGE_KF6_KCONFIGWIDGETS
	select BR2_PACKAGE_KF6_KCOREADDONS
	select BR2_PACKAGE_KF6_KCRASH
	select BR2_PACKAGE_KF6_KI18N
	select BR2_PACKAGE_KF6_KTEXTWIDGETS
	select BR2_PACKAGE_KF6_KXMLGUI
	select BR2_PACKAGE_QT6BASE
	help
	  KDE gear: sweeper 26.08.3. GENERATED by scripts/kde-gen.py.
```

## external/package/kde-systemsettings/Config.in
```kconfig
config BR2_PACKAGE_KDE_SYSTEMSETTINGS
	bool "kde-systemsettings"
	select BR2_PACKAGE_KDE_PLASMA_ACTIVITIES
	select BR2_PACKAGE_KF6_EXTRA_CMAKE_MODULES
	select BR2_PACKAGE_KF6_KAUTH
	select BR2_PACKAGE_KF6_KCMUTILS
	select BR2_PACKAGE_KF6_KCOLORSCHEME
	select BR2_PACKAGE_KF6_KCONFIG
	select BR2_PACKAGE_KF6_KCRASH
	select BR2_PACKAGE_KF6_KDBUSADDONS
	select BR2_PACKAGE_KF6_KGUIADDONS
	select BR2_PACKAGE_KF6_KI18N
	select BR2_PACKAGE_KF6_KICONTHEMES
	select BR2_PACKAGE_KF6_KIO
	select BR2_PACKAGE_KF6_KIRIGAMI
	select BR2_PACKAGE_KF6_KITEMMODELS
	select BR2_PACKAGE_KF6_KITEMVIEWS
	select BR2_PACKAGE_KF6_KRUNNER
	select BR2_PACKAGE_KF6_KSERVICE
	select BR2_PACKAGE_KF6_KWIDGETSADDONS
	select BR2_PACKAGE_KF6_KWINDOWSYSTEM
	select BR2_PACKAGE_KF6_KXMLGUI
	select BR2_PACKAGE_QT6BASE
	select BR2_PACKAGE_QT6DECLARATIVE
	help
	  KDE plasma: systemsettings 6.8.3. GENERATED by scripts/kde-gen.py.
```

## external/package/kde-xdg-desktop-portal-kde/Config.in
```kconfig
config BR2_PACKAGE_KDE_XDG_DESKTOP_PORTAL_KDE
	bool "kde-xdg-desktop-portal-kde"
	select BR2_PACKAGE_KDE_KWAYLAND
	select BR2_PACKAGE_KDE_PLASMA_WAYLAND_PROTOCOLS
	select BR2_PACKAGE_KDE_PLASMA_WORKSPACE
	select BR2_PACKAGE_KF6_EXTRA_CMAKE_MODULES
	select BR2_PACKAGE_KF6_KAUTH
	select BR2_PACKAGE_KF6_KCODECS
	select BR2_PACKAGE_KF6_KCOMPLETION
	select BR2_PACKAGE_KF6_KCONFIG
	select BR2_PACKAGE_KF6_KCONFIGWIDGETS
	select BR2_PACKAGE_KF6_KCOREADDONS
	select BR2_PACKAGE_KF6_KCRASH
	select BR2_PACKAGE_KF6_KDECLARATIVE
	select BR2_PACKAGE_KF6_KI18N
	select BR2_PACKAGE_KF6_KICONTHEMES
	select BR2_PACKAGE_KF6_KIO
	select BR2_PACKAGE_KF6_KIRIGAMI
	select BR2_PACKAGE_KF6_KITEMVIEWS
	select BR2_PACKAGE_KF6_KJOBWIDGETS
	select BR2_PACKAGE_KF6_KNOTIFICATIONS
	select BR2_PACKAGE_KF6_KSERVICE
	select BR2_PACKAGE_KF6_KSTATUSNOTIFIERITEM
	select BR2_PACKAGE_KF6_KWIDGETSADDONS
	select BR2_PACKAGE_KF6_KWINDOWSYSTEM
	select BR2_PACKAGE_KF6_KXMLGUI
	select BR2_PACKAGE_KF6_SOLID
	select BR2_PACKAGE_QT6BASE
	select BR2_PACKAGE_QT6DECLARATIVE
	select BR2_PACKAGE_QT6WAYLAND
	select BR2_PACKAGE_WAYLAND
	select BR2_PACKAGE_WAYLAND_PROTOCOLS
	help
	  KDE plasma: xdg-desktop-portal-kde 6.8.3. GENERATED by scripts/kde-gen.py.
```

## external/package/kf6-attica/Config.in
```kconfig
config BR2_PACKAGE_KF6_ATTICA
	bool "kf6-attica"
	select BR2_PACKAGE_KF6_EXTRA_CMAKE_MODULES
	select BR2_PACKAGE_QT6BASE
	help
	  KDE frameworks: attica 6.32.0. GENERATED by scripts/kde-gen.py.
```

## external/package/kf6-baloo/Config.in
```kconfig
config BR2_PACKAGE_KF6_BALOO
	bool "kf6-baloo"
	select BR2_PACKAGE_KF6_EXTRA_CMAKE_MODULES
	select BR2_PACKAGE_KF6_KCONFIG
	select BR2_PACKAGE_KF6_KCOREADDONS
	select BR2_PACKAGE_KF6_KCRASH
	select BR2_PACKAGE_KF6_KDBUSADDONS
	select BR2_PACKAGE_KF6_KFILEMETADATA
	select BR2_PACKAGE_KF6_KI18N
	select BR2_PACKAGE_KF6_KIDLETIME
	select BR2_PACKAGE_KF6_KIO
	select BR2_PACKAGE_KF6_SOLID
	select BR2_PACKAGE_LMDB
	select BR2_PACKAGE_QT6BASE
	select BR2_PACKAGE_QT6DECLARATIVE
	help
	  KDE frameworks: baloo 6.32.0. GENERATED by scripts/kde-gen.py.
```

## external/package/kf6-bluez-qt/Config.in
```kconfig
config BR2_PACKAGE_KF6_BLUEZ_QT
	bool "kf6-bluez-qt"
	select BR2_PACKAGE_KF6_EXTRA_CMAKE_MODULES
	select BR2_PACKAGE_QT6BASE
	select BR2_PACKAGE_QT6DECLARATIVE
	help
	  KDE frameworks: bluez-qt 6.32.0. GENERATED by scripts/kde-gen.py.
```
