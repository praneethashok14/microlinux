## external/package/kde-kpmcore/Config.in
```kconfig
config BR2_PACKAGE_KDE_KPMCORE
	bool "kde-kpmcore"
	select BR2_PACKAGE_KF6_EXTRA_CMAKE_MODULES
	select BR2_PACKAGE_KF6_KCOREADDONS
	select BR2_PACKAGE_KF6_KI18N
	select BR2_PACKAGE_KF6_KWIDGETSADDONS
	select BR2_PACKAGE_POLKIT_QT6
	select BR2_PACKAGE_QT6BASE
	help
	  KDE gear: kpmcore 26.08.3. GENERATED by scripts/kde-gen.py.
```

## external/package/kde-kquickimageeditor/Config.in
```kconfig
config BR2_PACKAGE_KDE_KQUICKIMAGEEDITOR
	bool "kde-kquickimageeditor"
	select BR2_PACKAGE_KF6_EXTRA_CMAKE_MODULES
	select BR2_PACKAGE_KF6_KCONFIG
	select BR2_PACKAGE_QT6BASE
	select BR2_PACKAGE_QT6DECLARATIVE
	select BR2_PACKAGE_QT6SHADERTOOLS
	help
	  KDE other: kquickimageeditor 0.7.0. GENERATED by scripts/kde-gen.py.
```

## external/package/kde-kruler/Config.in
```kconfig
config BR2_PACKAGE_KDE_KRULER
	bool "kde-kruler"
	select BR2_PACKAGE_KF6_EXTRA_CMAKE_MODULES
	select BR2_PACKAGE_KF6_KCRASH
	select BR2_PACKAGE_KF6_KI18N
	select BR2_PACKAGE_KF6_KNOTIFICATIONS
	select BR2_PACKAGE_KF6_KSTATUSNOTIFIERITEM
	select BR2_PACKAGE_KF6_KWINDOWSYSTEM
	select BR2_PACKAGE_KF6_KXMLGUI
	select BR2_PACKAGE_LIBXCB
	select BR2_PACKAGE_QT6BASE
	select BR2_PACKAGE_XCB_UTIL_CURSOR
	select BR2_PACKAGE_XCB_UTIL_IMAGE
	select BR2_PACKAGE_XCB_UTIL_KEYSYMS
	select BR2_PACKAGE_XCB_UTIL_WM
	help
	  KDE gear: kruler 26.08.3. GENERATED by scripts/kde-gen.py.
```

## external/package/kde-kscreen/Config.in
```kconfig
config BR2_PACKAGE_KDE_KSCREEN
	bool "kde-kscreen"
	select BR2_PACKAGE_KDE_LIBKSCREEN
	select BR2_PACKAGE_KDE_LIBPLASMA
	select BR2_PACKAGE_KF6_EXTRA_CMAKE_MODULES
	select BR2_PACKAGE_KF6_KAUTH
	select BR2_PACKAGE_KF6_KCMUTILS
	select BR2_PACKAGE_KF6_KCODECS
	select BR2_PACKAGE_KF6_KCONFIG
	select BR2_PACKAGE_KF6_KCONFIGWIDGETS
	select BR2_PACKAGE_KF6_KCOREADDONS
	select BR2_PACKAGE_KF6_KDBUSADDONS
	select BR2_PACKAGE_KF6_KI18N
	select BR2_PACKAGE_KF6_KIMAGEFORMATS
	select BR2_PACKAGE_KF6_KIRIGAMI
	select BR2_PACKAGE_KF6_KPACKAGE
	select BR2_PACKAGE_KF6_KSERVICE
	select BR2_PACKAGE_KF6_KSVG
	select BR2_PACKAGE_KF6_KWIDGETSADDONS
	select BR2_PACKAGE_KF6_KWINDOWSYSTEM
	select BR2_PACKAGE_KF6_KXMLGUI
	select BR2_PACKAGE_LAYER_SHELL_QT
	select BR2_PACKAGE_QT6BASE
	select BR2_PACKAGE_QT6DECLARATIVE
	select BR2_PACKAGE_QT6WAYLAND
	select BR2_PACKAGE_WAYLAND_PROTOCOLS
	help
	  KDE plasma: kscreen 6.8.3. GENERATED by scripts/kde-gen.py.
```

## external/package/kde-kscreenlocker/Config.in
```kconfig
config BR2_PACKAGE_KDE_KSCREENLOCKER
	bool "kde-kscreenlocker"
	select BR2_PACKAGE_KDE_LIBKSCREEN
	select BR2_PACKAGE_KDE_LIBPLASMA
	select BR2_PACKAGE_KF6_EXTRA_CMAKE_MODULES
	select BR2_PACKAGE_KF6_KAUTH
	select BR2_PACKAGE_KF6_KCMUTILS
	select BR2_PACKAGE_KF6_KCODECS
	select BR2_PACKAGE_KF6_KCONFIG
	select BR2_PACKAGE_KF6_KCONFIGWIDGETS
	select BR2_PACKAGE_KF6_KCOREADDONS
	select BR2_PACKAGE_KF6_KCRASH
	select BR2_PACKAGE_KF6_KDECLARATIVE
	select BR2_PACKAGE_KF6_KGLOBALACCEL
	select BR2_PACKAGE_KF6_KI18N
	select BR2_PACKAGE_KF6_KIDLETIME
	select BR2_PACKAGE_KF6_KNOTIFICATIONS
	select BR2_PACKAGE_KF6_KSERVICE
	select BR2_PACKAGE_KF6_KSVG
	select BR2_PACKAGE_KF6_KWIDGETSADDONS
	select BR2_PACKAGE_KF6_KWINDOWSYSTEM
	select BR2_PACKAGE_KF6_KXMLGUI
	select BR2_PACKAGE_LAYER_SHELL_QT
	select BR2_PACKAGE_LINUX_PAM
	select BR2_PACKAGE_QT6BASE
	select BR2_PACKAGE_QT6DECLARATIVE
	help
	  KDE plasma: kscreenlocker 6.8.3. GENERATED by scripts/kde-gen.py.
```

## external/package/kde-ksudoku/Config.in
```kconfig
config BR2_PACKAGE_KDE_KSUDOKU
	bool "kde-ksudoku"
	select BR2_PACKAGE_KDE_LIBKDEGAMES
	select BR2_PACKAGE_KF6_EXTRA_CMAKE_MODULES
	select BR2_PACKAGE_KF6_KARCHIVE
	select BR2_PACKAGE_KF6_KCONFIG
	select BR2_PACKAGE_KF6_KCONFIGWIDGETS
	select BR2_PACKAGE_KF6_KCOREADDONS
	select BR2_PACKAGE_KF6_KCRASH
	select BR2_PACKAGE_KF6_KDBUSADDONS
	select BR2_PACKAGE_KF6_KGUIADDONS
	select BR2_PACKAGE_KF6_KI18N
	select BR2_PACKAGE_KF6_KICONTHEMES
	select BR2_PACKAGE_KF6_KIO
	select BR2_PACKAGE_KF6_KJOBWIDGETS
	select BR2_PACKAGE_KF6_KWIDGETSADDONS
	select BR2_PACKAGE_KF6_KXMLGUI
	select BR2_PACKAGE_QT6BASE
	select BR2_PACKAGE_QT6SVG
	help
	  KDE gear: ksudoku 26.08.3. GENERATED by scripts/kde-gen.py.
```

## external/package/kde-ksystemlog/Config.in
```kconfig
config BR2_PACKAGE_KDE_KSYSTEMLOG
	bool "kde-ksystemlog"
	select BR2_PACKAGE_KF6_EXTRA_CMAKE_MODULES
	select BR2_PACKAGE_KF6_KARCHIVE
	select BR2_PACKAGE_KF6_KCOMPLETION
	select BR2_PACKAGE_KF6_KCONFIG
	select BR2_PACKAGE_KF6_KCOREADDONS
	select BR2_PACKAGE_KF6_KCRASH
	select BR2_PACKAGE_KF6_KI18N
	select BR2_PACKAGE_KF6_KIO
	select BR2_PACKAGE_KF6_KITEMVIEWS
	select BR2_PACKAGE_KF6_KTEXTWIDGETS
	select BR2_PACKAGE_KF6_KWIDGETSADDONS
	select BR2_PACKAGE_KF6_KXMLGUI
	select BR2_PACKAGE_QT6BASE
	help
	  KDE gear: ksystemlog 26.08.3. GENERATED by scripts/kde-gen.py.
```

## external/package/kde-ksystemstats/Config.in
```kconfig
config BR2_PACKAGE_KDE_KSYSTEMSTATS
	bool "kde-ksystemstats"
	select BR2_PACKAGE_EUDEV
	select BR2_PACKAGE_KDE_LIBKSYSGUARD
	select BR2_PACKAGE_KF6_EXTRA_CMAKE_MODULES
	select BR2_PACKAGE_KF6_KCOREADDONS
	select BR2_PACKAGE_KF6_KCRASH
	select BR2_PACKAGE_KF6_KIO
	select BR2_PACKAGE_KF6_SOLID
	select BR2_PACKAGE_LIBCAP
	select BR2_PACKAGE_LIBNL
	select BR2_PACKAGE_LM_SENSORS
	select BR2_PACKAGE_QT6BASE
	help
	  KDE plasma: ksystemstats 6.8.3. GENERATED by scripts/kde-gen.py.
```

## external/package/kde-kwallet-pam/Config.in
```kconfig
config BR2_PACKAGE_KDE_KWALLET_PAM
	bool "kde-kwallet-pam"
	select BR2_PACKAGE_KF6_EXTRA_CMAKE_MODULES
	select BR2_PACKAGE_KF6_KWALLET
	select BR2_PACKAGE_LINUX_PAM
	select BR2_PACKAGE_QT6BASE
	help
	  KDE plasma: kwallet-pam 6.8.3. GENERATED by scripts/kde-gen.py.
```

## external/package/kde-kwalletmanager/Config.in
```kconfig
config BR2_PACKAGE_KDE_KWALLETMANAGER
	bool "kde-kwalletmanager"
	select BR2_PACKAGE_KF6_EXTRA_CMAKE_MODULES
	select BR2_PACKAGE_KF6_KARCHIVE
	select BR2_PACKAGE_KF6_KAUTH
	select BR2_PACKAGE_KF6_KCMUTILS
	select BR2_PACKAGE_KF6_KCONFIG
	select BR2_PACKAGE_KF6_KCONFIGWIDGETS
	select BR2_PACKAGE_KF6_KCOREADDONS
	select BR2_PACKAGE_KF6_KCRASH
	select BR2_PACKAGE_KF6_KDBUSADDONS
	select BR2_PACKAGE_KF6_KI18N
	select BR2_PACKAGE_KF6_KIO
	select BR2_PACKAGE_KF6_KSERVICE
	select BR2_PACKAGE_KF6_KSTATUSNOTIFIERITEM
	select BR2_PACKAGE_KF6_KWALLET
	select BR2_PACKAGE_KF6_KWIDGETSADDONS
	select BR2_PACKAGE_KF6_KWINDOWSYSTEM
	select BR2_PACKAGE_KF6_KXMLGUI
	select BR2_PACKAGE_QT6BASE
	help
	  KDE gear: kwalletmanager 26.08.3. GENERATED by scripts/kde-gen.py.
```

## external/package/kde-kwayland/Config.in
```kconfig
config BR2_PACKAGE_KDE_KWAYLAND
	bool "kde-kwayland"
	select BR2_PACKAGE_KDE_PLASMA_WAYLAND_PROTOCOLS
	select BR2_PACKAGE_KF6_EXTRA_CMAKE_MODULES
	select BR2_PACKAGE_MESA3D
	select BR2_PACKAGE_QT6BASE
	select BR2_PACKAGE_QT6WAYLAND
	select BR2_PACKAGE_WAYLAND
	select BR2_PACKAGE_WAYLAND_PROTOCOLS
	help
	  KDE plasma: kwayland 6.8.3. GENERATED by scripts/kde-gen.py.
```

## external/package/kde-kwin/Config.in
```kconfig
config BR2_PACKAGE_KDE_KWIN
	bool "kde-kwin"
	select BR2_PACKAGE_EUDEV
	select BR2_PACKAGE_HWDATA
	select BR2_PACKAGE_KDE_AURORAE
	select BR2_PACKAGE_KDE_BREEZE
	select BR2_PACKAGE_KDE_KDECORATION
	select BR2_PACKAGE_KDE_KGLOBALACCELD
	select BR2_PACKAGE_KDE_KNIGHTTIME
	select BR2_PACKAGE_KDE_KPIPEWIRE
	select BR2_PACKAGE_KDE_KSCREENLOCKER
	select BR2_PACKAGE_KDE_KWAYLAND
	select BR2_PACKAGE_KDE_LIBPLASMA
	select BR2_PACKAGE_KDE_MILOU
	select BR2_PACKAGE_KDE_PLASMA_ACTIVITIES
	select BR2_PACKAGE_KDE_PLASMA_WAYLAND_PROTOCOLS
	select BR2_PACKAGE_KF6_BREEZE_ICONS
	select BR2_PACKAGE_KF6_EXTRA_CMAKE_MODULES
	select BR2_PACKAGE_KF6_KCMUTILS
	select BR2_PACKAGE_KF6_KCOLORSCHEME
	select BR2_PACKAGE_KF6_KCONFIG
	select BR2_PACKAGE_KF6_KCOREADDONS
	select BR2_PACKAGE_KF6_KCRASH
	select BR2_PACKAGE_KF6_KDECLARATIVE
	select BR2_PACKAGE_KF6_KGLOBALACCEL
	select BR2_PACKAGE_KF6_KI18N
	select BR2_PACKAGE_KF6_KIDLETIME
	select BR2_PACKAGE_KF6_KIRIGAMI
	select BR2_PACKAGE_KF6_KNEWSTUFF
	select BR2_PACKAGE_KF6_KNOTIFICATIONS
	select BR2_PACKAGE_KF6_KPACKAGE
	select BR2_PACKAGE_KF6_KSERVICE
	select BR2_PACKAGE_KF6_KSVG
	select BR2_PACKAGE_KF6_KWIDGETSADDONS
	select BR2_PACKAGE_KF6_KWINDOWSYSTEM
	select BR2_PACKAGE_KF6_KXMLGUI
	select BR2_PACKAGE_LCMS2
	select BR2_PACKAGE_LIBCANBERRA
	select BR2_PACKAGE_LIBCAP
	select BR2_PACKAGE_LIBDRM
	select BR2_PACKAGE_LIBEPOXY
	select BR2_PACKAGE_LIBINPUT
	select BR2_PACKAGE_LIBXCB
	select BR2_PACKAGE_LIBXKBCOMMON
	select BR2_PACKAGE_MESA3D
	select BR2_PACKAGE_QT6BASE
	select BR2_PACKAGE_QT6CORE5COMPAT
	select BR2_PACKAGE_QT6DECLARATIVE
	select BR2_PACKAGE_QT6SVG
	select BR2_PACKAGE_QT6WAYLAND
	select BR2_PACKAGE_WAYLAND
	select BR2_PACKAGE_WAYLAND_PROTOCOLS
	select BR2_PACKAGE_XCB_UTIL_CURSOR
	select BR2_PACKAGE_XCB_UTIL_IMAGE
	select BR2_PACKAGE_XCB_UTIL_KEYSYMS
	select BR2_PACKAGE_XCB_UTIL_WM
	select BR2_PACKAGE_XLIB_LIBX11
	select BR2_PACKAGE_XWAYLAND
	help
	  KDE plasma: kwin 6.8.3. GENERATED by scripts/kde-gen.py.
```

## external/package/kde-kwrited/Config.in
```kconfig
config BR2_PACKAGE_KDE_KWRITED
	bool "kde-kwrited"
	select BR2_PACKAGE_KF6_EXTRA_CMAKE_MODULES
	select BR2_PACKAGE_KF6_KCOREADDONS
	select BR2_PACKAGE_KF6_KDBUSADDONS
	select BR2_PACKAGE_KF6_KI18N
	select BR2_PACKAGE_KF6_KNOTIFICATIONS
	select BR2_PACKAGE_KF6_KPTY
	select BR2_PACKAGE_QT6BASE
	help
	  KDE plasma: kwrited 6.8.3. GENERATED by scripts/kde-gen.py.
```

## external/package/kde-libkdcraw/Config.in
```kconfig
config BR2_PACKAGE_KDE_LIBKDCRAW
	bool "kde-libkdcraw"
	select BR2_PACKAGE_KF6_EXTRA_CMAKE_MODULES
	select BR2_PACKAGE_QT6BASE
	help
	  KDE gear: libkdcraw 26.08.3. GENERATED by scripts/kde-gen.py.
```

## external/package/kde-libkdegames/Config.in
```kconfig
config BR2_PACKAGE_KDE_LIBKDEGAMES
	bool "kde-libkdegames"
	select BR2_PACKAGE_KF6_EXTRA_CMAKE_MODULES
	select BR2_PACKAGE_KF6_KARCHIVE
	select BR2_PACKAGE_KF6_KCOLORSCHEME
	select BR2_PACKAGE_KF6_KCOMPLETION
	select BR2_PACKAGE_KF6_KCONFIG
	select BR2_PACKAGE_KF6_KCONFIGWIDGETS
	select BR2_PACKAGE_KF6_KDNSSD
	select BR2_PACKAGE_KF6_KGUIADDONS
	select BR2_PACKAGE_KF6_KI18N
	select BR2_PACKAGE_KF6_KICONTHEMES
	select BR2_PACKAGE_KF6_KNEWSTUFF
	select BR2_PACKAGE_KF6_KXMLGUI
	select BR2_PACKAGE_LIBSNDFILE
	select BR2_PACKAGE_OPENAL
	select BR2_PACKAGE_QT6BASE
	select BR2_PACKAGE_QT6DECLARATIVE
	select BR2_PACKAGE_QT6SVG
	help
	  KDE gear: libkdegames 26.08.3. GENERATED by scripts/kde-gen.py.
```

## external/package/kde-libkexiv2/Config.in
```kconfig
config BR2_PACKAGE_KDE_LIBKEXIV2
	bool "kde-libkexiv2"
	select BR2_PACKAGE_EXIV2
	select BR2_PACKAGE_KF6_EXTRA_CMAKE_MODULES
	select BR2_PACKAGE_QT6BASE
	help
	  KDE gear: libkexiv2 26.08.3. GENERATED by scripts/kde-gen.py.
```

## external/package/kde-libkscreen/Config.in
```kconfig
config BR2_PACKAGE_KDE_LIBKSCREEN
	bool "kde-libkscreen"
	select BR2_PACKAGE_KDE_PLASMA_WAYLAND_PROTOCOLS
	select BR2_PACKAGE_KF6_EXTRA_CMAKE_MODULES
	select BR2_PACKAGE_QT6BASE
	select BR2_PACKAGE_QT6WAYLAND
	select BR2_PACKAGE_WAYLAND
	help
	  KDE plasma: libkscreen 6.8.3. GENERATED by scripts/kde-gen.py.
```

## external/package/kde-libksysguard/Config.in
```kconfig
config BR2_PACKAGE_KDE_LIBKSYSGUARD
	bool "kde-libksysguard"
	select BR2_PACKAGE_EUDEV
	select BR2_PACKAGE_KF6_EXTRA_CMAKE_MODULES
	select BR2_PACKAGE_KF6_KAUTH
	select BR2_PACKAGE_KF6_KCONFIG
	select BR2_PACKAGE_KF6_KCOREADDONS
	select BR2_PACKAGE_KF6_KI18N
	select BR2_PACKAGE_KF6_KNEWSTUFF
	select BR2_PACKAGE_KF6_KPACKAGE
	select BR2_PACKAGE_KF6_KSERVICE
	select BR2_PACKAGE_KF6_SOLID
	select BR2_PACKAGE_LIBCAP
	select BR2_PACKAGE_LIBDRM
	select BR2_PACKAGE_LIBNL
	select BR2_PACKAGE_LM_SENSORS
	select BR2_PACKAGE_QT6BASE
	select BR2_PACKAGE_QT6DECLARATIVE
	select BR2_PACKAGE_ZLIB
	help
	  KDE plasma: libksysguard 6.8.3. GENERATED by scripts/kde-gen.py.
```

## external/package/kde-libplasma/Config.in
```kconfig
config BR2_PACKAGE_KDE_LIBPLASMA
	bool "kde-libplasma"
	select BR2_PACKAGE_KDE_PLASMA_ACTIVITIES
	select BR2_PACKAGE_KDE_PLASMA_WAYLAND_PROTOCOLS
	select BR2_PACKAGE_KF6_EXTRA_CMAKE_MODULES
	select BR2_PACKAGE_KF6_KARCHIVE
	select BR2_PACKAGE_KF6_KCOLORSCHEME
	select BR2_PACKAGE_KF6_KCONFIG
	select BR2_PACKAGE_KF6_KCOREADDONS
	select BR2_PACKAGE_KF6_KDBUSADDONS
	select BR2_PACKAGE_KF6_KGLOBALACCEL
	select BR2_PACKAGE_KF6_KGUIADDONS
	select BR2_PACKAGE_KF6_KI18N
	select BR2_PACKAGE_KF6_KICONTHEMES
	select BR2_PACKAGE_KF6_KIO
	select BR2_PACKAGE_KF6_KIRIGAMI
	select BR2_PACKAGE_KF6_KNOTIFICATIONS
	select BR2_PACKAGE_KF6_KPACKAGE
	select BR2_PACKAGE_KF6_KPARTS
	select BR2_PACKAGE_KF6_KSVG
	select BR2_PACKAGE_KF6_KWIDGETSADDONS
	select BR2_PACKAGE_KF6_KWINDOWSYSTEM
	select BR2_PACKAGE_QT6BASE
	select BR2_PACKAGE_QT6DECLARATIVE
	select BR2_PACKAGE_QT6SVG
	select BR2_PACKAGE_QT6WAYLAND
	select BR2_PACKAGE_WAYLAND
	select BR2_PACKAGE_WAYLAND_PROTOCOLS
	help
	  KDE plasma: libplasma 6.8.3. GENERATED by scripts/kde-gen.py.
```

## external/package/kde-milou/Config.in
```kconfig
config BR2_PACKAGE_KDE_MILOU
	bool "kde-milou"
	select BR2_PACKAGE_KDE_LIBPLASMA
	select BR2_PACKAGE_KF6_EXTRA_CMAKE_MODULES
	select BR2_PACKAGE_KF6_KCONFIG
	select BR2_PACKAGE_KF6_KI18N
	select BR2_PACKAGE_KF6_KRUNNER
	select BR2_PACKAGE_QT6BASE
	select BR2_PACKAGE_QT6DECLARATIVE
	help
	  KDE plasma: milou 6.8.3. GENERATED by scripts/kde-gen.py.
```

## external/package/kde-ocean-sound-theme/Config.in
```kconfig
config BR2_PACKAGE_KDE_OCEAN_SOUND_THEME
	bool "kde-ocean-sound-theme"
	select BR2_PACKAGE_KF6_EXTRA_CMAKE_MODULES
	select BR2_PACKAGE_QT6BASE
	help
	  KDE plasma: ocean-sound-theme 6.8.3. GENERATED by scripts/kde-gen.py.
```

## external/package/kde-okular/Config.in
```kconfig
config BR2_PACKAGE_KDE_OKULAR
	bool "kde-okular"
	select BR2_PACKAGE_FREETYPE
	select BR2_PACKAGE_KDE_KDEGRAPHICS_MOBIPOCKET
	select BR2_PACKAGE_KDE_KIRIGAMI_ADDONS
	select BR2_PACKAGE_KDE_LIBKEXIV2
	select BR2_PACKAGE_KF6_BREEZE_ICONS
	select BR2_PACKAGE_KF6_EXTRA_CMAKE_MODULES
	select BR2_PACKAGE_KF6_KARCHIVE
	select BR2_PACKAGE_KF6_KBOOKMARKS
	select BR2_PACKAGE_KF6_KCOLORSCHEME
	select BR2_PACKAGE_KF6_KI18N
	select BR2_PACKAGE_KF6_KIO
	select BR2_PACKAGE_KF6_KPARTS
	select BR2_PACKAGE_KF6_KTEXTWIDGETS
	select BR2_PACKAGE_KF6_KWIDGETSADDONS
	select BR2_PACKAGE_KF6_KXMLGUI
	select BR2_PACKAGE_KF6_PURPOSE
	select BR2_PACKAGE_KF6_THREADWEAVER
	select BR2_PACKAGE_POPPLER
	select BR2_PACKAGE_QT6BASE
	select BR2_PACKAGE_QT6DECLARATIVE
	select BR2_PACKAGE_QT6SVG
	select BR2_PACKAGE_TIFF
	select BR2_PACKAGE_ZLIB
	help
	  KDE gear: okular 26.08.3. GENERATED by scripts/kde-gen.py.
```

## external/package/kde-partitionmanager/Config.in
```kconfig
config BR2_PACKAGE_KDE_PARTITIONMANAGER
	bool "kde-partitionmanager"
	select BR2_PACKAGE_KDE_KPMCORE
	select BR2_PACKAGE_KF6_EXTRA_CMAKE_MODULES
	select BR2_PACKAGE_KF6_KCONFIG
	select BR2_PACKAGE_KF6_KCONFIGWIDGETS
	select BR2_PACKAGE_KF6_KCOREADDONS
	select BR2_PACKAGE_KF6_KCRASH
	select BR2_PACKAGE_KF6_KDBUSADDONS
	select BR2_PACKAGE_KF6_KI18N
	select BR2_PACKAGE_KF6_KIO
	select BR2_PACKAGE_KF6_KJOBWIDGETS
	select BR2_PACKAGE_KF6_KWIDGETSADDONS
	select BR2_PACKAGE_KF6_KXMLGUI
	select BR2_PACKAGE_POLKIT_QT6
	select BR2_PACKAGE_QT6BASE
	help
	  KDE gear: partitionmanager 26.08.3. GENERATED by scripts/kde-gen.py.
```

## external/package/kde-plasma-activities-stats/Config.in
```kconfig
config BR2_PACKAGE_KDE_PLASMA_ACTIVITIES_STATS
	bool "kde-plasma-activities-stats"
	select BR2_PACKAGE_BOOST
	select BR2_PACKAGE_KDE_KACTIVITYMANAGERD
	select BR2_PACKAGE_KDE_PLASMA_ACTIVITIES
	select BR2_PACKAGE_KF6_EXTRA_CMAKE_MODULES
	select BR2_PACKAGE_QT6BASE
	help
	  KDE plasma: plasma-activities-stats 6.8.3. GENERATED by scripts/kde-gen.py.
```
