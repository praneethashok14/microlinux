## external/package/kde-plasma-activities/Config.in
```kconfig
config BR2_PACKAGE_KDE_PLASMA_ACTIVITIES
	bool "kde-plasma-activities"
	select BR2_PACKAGE_KF6_EXTRA_CMAKE_MODULES
	select BR2_PACKAGE_KF6_KCONFIG
	select BR2_PACKAGE_KF6_KCOREADDONS
	select BR2_PACKAGE_KF6_KWINDOWSYSTEM
	select BR2_PACKAGE_QT6BASE
	select BR2_PACKAGE_QT6DECLARATIVE
	help
	  KDE plasma: plasma-activities 6.8.3. GENERATED by scripts/kde-gen.py.
```
