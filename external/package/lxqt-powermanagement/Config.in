## external/package/lxqt-powermanagement/Config.in
```kconfig
config BR2_PACKAGE_LXQT_POWERMANAGEMENT
	bool "lxqt-powermanagement"
	select BR2_PACKAGE_LIBLXQT
	select BR2_PACKAGE_LXQT_GLOBALKEYS
	select BR2_PACKAGE_KF6_KIDLETIME
	select BR2_PACKAGE_KF6_SOLID
	select BR2_PACKAGE_QT6SVG
	select BR2_PACKAGE_LIBXCB
	select BR2_PACKAGE_UPOWER
	select BR2_PACKAGE_QT6
	select BR2_PACKAGE_QT6BASE_GUI
	select BR2_PACKAGE_QT6BASE_WIDGETS
	select BR2_PACKAGE_QT6BASE_DBUS
	select BR2_PACKAGE_HOST_QT6TOOLS
	select BR2_PACKAGE_HOST_QT6TOOLS_LINGUIST_TOOLS
	help
	  LXQt power management: battery, lid and idle actions.

	  https://github.com/lxqt/lxqt-powermanagement
```

## external/package/lxqt-qtplugin/Config.in
```kconfig
config BR2_PACKAGE_LXQT_QTPLUGIN
	bool "lxqt-qtplugin"
	select BR2_PACKAGE_LXQT_BUILD_TOOLS
	select BR2_PACKAGE_LIBQTXDG
	select BR2_PACKAGE_LIBDBUSMENU_LXQT
	select BR2_PACKAGE_LIBFM_QT
	select BR2_PACKAGE_QT6
	select BR2_PACKAGE_QT6BASE_GUI
	select BR2_PACKAGE_QT6BASE_WIDGETS
	select BR2_PACKAGE_QT6BASE_DBUS
	select BR2_PACKAGE_HOST_QT6TOOLS
	select BR2_PACKAGE_HOST_QT6TOOLS_LINGUIST_TOOLS
	help
	  LXQt Qt platform theme plugin: applies LXQt's theme, icons and
	  file dialogs to every Qt program.

	  https://github.com/lxqt/lxqt-qtplugin
```

## external/package/lxqt-runner/Config.in
```kconfig
config BR2_PACKAGE_LXQT_RUNNER
	bool "lxqt-runner"
	select BR2_PACKAGE_LIBLXQT
	select BR2_PACKAGE_LXQT_GLOBALKEYS
	select BR2_PACKAGE_KF6_KWINDOWSYSTEM
	select BR2_PACKAGE_LAYER_SHELL_QT
	select BR2_PACKAGE_MUPARSER
	select BR2_PACKAGE_QT6BASE_XML
	select BR2_PACKAGE_QT6
	select BR2_PACKAGE_QT6BASE_GUI
	select BR2_PACKAGE_QT6BASE_WIDGETS
	select BR2_PACKAGE_QT6BASE_DBUS
	select BR2_PACKAGE_HOST_QT6TOOLS
	select BR2_PACKAGE_HOST_QT6TOOLS_LINGUIST_TOOLS
	help
	  LXQt runner: quick launcher and calculator (Alt+F2).

	  https://github.com/lxqt/lxqt-runner
```

## external/package/lxqt-session/Config.in
```kconfig
config BR2_PACKAGE_LXQT_SESSION
	bool "lxqt-session"
	select BR2_PACKAGE_LIBLXQT
	select BR2_PACKAGE_KF6_KWINDOWSYSTEM
	select BR2_PACKAGE_LAYER_SHELL_QT
	select BR2_PACKAGE_QTXDG_TOOLS
	select BR2_PACKAGE_XDG_USER_DIRS
	select BR2_PACKAGE_PROCPS_NG
	select BR2_PACKAGE_XLIB_LIBX11
	select BR2_PACKAGE_QT6
	select BR2_PACKAGE_QT6BASE_GUI
	select BR2_PACKAGE_QT6BASE_WIDGETS
	select BR2_PACKAGE_QT6BASE_DBUS
	select BR2_PACKAGE_HOST_QT6TOOLS
	select BR2_PACKAGE_HOST_QT6TOOLS_LINGUIST_TOOLS
	help
	  LXQt session manager (startlxqt, lxqt-leave, autostart).

	  https://github.com/lxqt/lxqt-session
```

## external/package/ml-installer/Config.in
```kconfig
config BR2_PACKAGE_ML_INSTALLER
	bool "ml-installer (MicroLinux graphical installer)"
	depends on BR2_PACKAGE_HOST_RUSTC_TARGET_ARCH_SUPPORTS
	select BR2_PACKAGE_HOST_RUSTC
	help
	  Graphical installer for MicroLinux, written in Rust with egui:
	  choose a disk (erase it, or install alongside Windows), set the
	  host name and passwords, and watch the installation. The work
	  is done by ml-install, run through sudo.
```

## external/package/ml-settings/Config.in
```kconfig
config BR2_PACKAGE_ML_SETTINGS
	bool "ml-settings (MicroLinux settings application)"
	depends on BR2_PACKAGE_LIBGTK3
	select BR2_PACKAGE_ALSA_LIB
	help
	  GTK 3 settings application for MicroLinux: network and Wi-Fi,
	  Bluetooth, display, sound, wallpaper, keyboard, date and time,
	  password, packages (mlpkg) and system information. Privileged
	  changes go through sudo -A with a graphical password prompt.
```

## external/package/ml-software/Config.in
```kconfig
config BR2_PACKAGE_ML_SOFTWARE
	bool "ml-software (MicroLinux Software: package browser for mlpkg)"
	depends on BR2_PACKAGE_LIBGTK3
	depends on BR2_PACKAGE_ML_SETTINGS # ml-askpass
	help
	  Graphical front end for mlpkg: browse the package repository by
	  category, search, install, remove and update packages. Published
	  in the package repository (sudo mlpkg install ml-software).
```

## external/package/muparser/Config.in
```kconfig
config BR2_PACKAGE_MUPARSER
	bool "muparser"
	depends on BR2_INSTALL_LIBSTDCPP
	help
	  muparser: a fast math expression parser library (used by the
	  LXQt runner as a calculator).

	  https://beltoforion.de/en/muparser/
```

## external/package/ncurses5-compat/Config.in
```kconfig
config BR2_PACKAGE_NCURSES5_COMPAT
	bool "ncurses5-compat (ABI 5 libraries)"
	help
	  ncurses built with --with-abi-version=5, providing libtinfo.so.5,
	  libncurses.so.5, libncursesw.so.5 and the form/menu/panel
	  libraries for binaries built on RHEL/CentOS 7 (ncurses 5.9).
	  Only shared libraries are installed.
```

## external/package/pcmanfm-qt/Config.in
```kconfig
config BR2_PACKAGE_PCMANFM_QT
	bool "pcmanfm-qt"
	select BR2_PACKAGE_LIBFM_QT
	select BR2_PACKAGE_LAYER_SHELL_QT
	select BR2_PACKAGE_LXQT_BUILD_TOOLS
	select BR2_PACKAGE_QT6
	select BR2_PACKAGE_QT6BASE_GUI
	select BR2_PACKAGE_QT6BASE_WIDGETS
	select BR2_PACKAGE_QT6BASE_DBUS
	select BR2_PACKAGE_HOST_QT6TOOLS
	select BR2_PACKAGE_HOST_QT6TOOLS_LINGUIST_TOOLS
	help
	  PCManFM-Qt: the LXQt file manager, also draws the desktop
	  (wallpaper and icons).

	  https://github.com/lxqt/pcmanfm-qt
```

## external/package/polkit-qt6/Config.in
```kconfig
config BR2_PACKAGE_POLKIT_QT6
	bool "polkit-qt6"
	select BR2_PACKAGE_POLKIT
	select BR2_PACKAGE_QT6BASE_DBUS
	select BR2_PACKAGE_QT6BASE_GUI
	select BR2_PACKAGE_QT6BASE_WIDGETS
	help
	  Polkit-Qt: Qt 6 bindings for the polkit authorization
	  library.

	  https://invent.kde.org/libraries/polkit-qt-1
```

## external/package/prismlauncher-bin/Config.in
```kconfig
config BR2_PACKAGE_PRISMLAUNCHER_BIN
	bool "prismlauncher-bin (Minecraft launcher, for the package repository)"
	depends on BR2_aarch64 || BR2_x86_64
	depends on BR2_PACKAGE_TEMURIN_JRE_BIN
	help
	  Prism Launcher, an open-source Minecraft launcher (instances,
	  mods, modpacks, Microsoft accounts), self-contained portable
	  build. Not put on the ISO: published in the package repository
	  as the image package "prismlauncher" (mounted at
	  /opt/prismlauncher), which depends on openjdk-25-jre.

	  https://prismlauncher.org/
```

## external/package/qt5-base/Config.in
```kconfig
config BR2_PACKAGE_QT5_BASE
	bool "qt5-base"
	depends on BR2_INSTALL_LIBSTDCPP
	select BR2_PACKAGE_PCRE2
	select BR2_PACKAGE_PCRE2_16
	select BR2_PACKAGE_ZLIB
	select BR2_PACKAGE_FREETYPE
	select BR2_PACKAGE_HARFBUZZ
	select BR2_PACKAGE_FONTCONFIG
	select BR2_PACKAGE_LIBPNG
	select BR2_PACKAGE_JPEG
	select BR2_PACKAGE_DBUS
	select BR2_PACKAGE_LIBGLIB2
	select BR2_PACKAGE_OPENSSL
	select BR2_PACKAGE_ZSTD
	select BR2_PACKAGE_LIBXKBCOMMON
	select BR2_PACKAGE_LIBXCB
	select BR2_PACKAGE_XCB_UTIL_WM
	select BR2_PACKAGE_XCB_UTIL_IMAGE
	select BR2_PACKAGE_XCB_UTIL_KEYSYMS
	select BR2_PACKAGE_XCB_UTIL_RENDERUTIL
	select BR2_PACKAGE_XLIB_LIBX11
	select BR2_PACKAGE_XLIB_LIBXEXT
	help
	  Qt 5.15 base libraries for programs made for Qt 5: libQt5Core,
	  libQt5Gui, libQt5Widgets, Network, DBus, Xml, Concurrent,
	  PrintSupport, OpenGL, with the X11 platform plugin.
```

## external/package/qterminal/Config.in
```kconfig
config BR2_PACKAGE_QTERMINAL
	bool "qterminal"
	select BR2_PACKAGE_QTERMWIDGET
	select BR2_PACKAGE_LAYER_SHELL_QT
	select BR2_PACKAGE_LXQT_BUILD_TOOLS
	select BR2_PACKAGE_XLIB_LIBX11
	select BR2_PACKAGE_QT6
	select BR2_PACKAGE_QT6BASE_GUI
	select BR2_PACKAGE_QT6BASE_WIDGETS
	select BR2_PACKAGE_QT6BASE_DBUS
	select BR2_PACKAGE_HOST_QT6TOOLS
	select BR2_PACKAGE_HOST_QT6TOOLS_LINGUIST_TOOLS
	help
	  QTerminal: the LXQt terminal emulator.

	  https://github.com/lxqt/qterminal
```

## external/package/qtxdg-tools/Config.in
```kconfig
config BR2_PACKAGE_QTXDG_TOOLS
	bool "qtxdg-tools"
	select BR2_PACKAGE_LXQT_BUILD_TOOLS
	select BR2_PACKAGE_LIBQTXDG
	select BR2_PACKAGE_QT6
	select BR2_PACKAGE_QT6BASE_GUI
	select BR2_PACKAGE_QT6BASE_WIDGETS
	select BR2_PACKAGE_QT6BASE_DBUS
	select BR2_PACKAGE_HOST_QT6TOOLS
	select BR2_PACKAGE_HOST_QT6TOOLS_LINGUIST_TOOLS
	help
	  qtxdg-tools: command line tools (qtxdg-mat) of libqtxdg.

	  https://github.com/lxqt/qtxdg-tools
```

## external/package/shim-signed-bin/Config.in
```kconfig
config BR2_PACKAGE_SHIM_SIGNED_BIN
	bool "shim-signed-bin (Microsoft-signed shim from Debian, for Secure Boot)"
	depends on BR2_x86_64
	help
	  The shim boot loader signed by Microsoft's UEFI CA (Debian's
	  shim-signed) and Debian's signed MOK Manager. With them the
	  MicroLinux GRUB and kernel, signed with the MicroLinux key, boot
	  with Secure Boot enabled once that key has been enrolled with MOK
	  Manager. The files are installed to images/shim/ for post-image.sh.
```

## external/package/temurin-jre-bin/Config.in
```kconfig
config BR2_PACKAGE_TEMURIN_JRE_BIN
	bool "temurin-jre-bin (Java 25/21/17/8, for the package repository)"
	depends on BR2_aarch64 || BR2_x86_64
	depends on BR2_TOOLCHAIN_USES_GLIBC
	help
	  Eclipse Temurin Java runtimes (OpenJDK builds) 25, 21, 17 and 8.
	  Not put on the ISO: published in the package repository as the
	  image packages openjdk-<N>-jre, mounted at /opt/openjdk-<N>-jre
	  (where Prism Launcher finds them).

	  https://adoptium.net/
```

## external/package/xdg-user-dirs/Config.in
```kconfig
config BR2_PACKAGE_XDG_USER_DIRS
	bool "xdg-user-dirs"
	help
	  xdg-user-dirs: creates and looks up the user's well known
	  folders (Desktop, Documents, Downloads, ...).

	  https://www.freedesktop.org/wiki/Software/xdg-user-dirs/
```
