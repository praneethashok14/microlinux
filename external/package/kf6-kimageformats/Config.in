## external/package/kf6-kimageformats/Config.in
```kconfig
config BR2_PACKAGE_KF6_KIMAGEFORMATS
	bool "kf6-kimageformats"
	select BR2_PACKAGE_KF6_EXTRA_CMAKE_MODULES
	select BR2_PACKAGE_KF6_KARCHIVE
	select BR2_PACKAGE_QT6BASE
	help
	  KDE frameworks: kimageformats 6.32.0. GENERATED by scripts/kde-gen.py.
```

## external/package/kf6-kio/Config.in
```kconfig
config BR2_PACKAGE_KF6_KIO
	bool "kf6-kio"
	select BR2_PACKAGE_ACL
	select BR2_PACKAGE_KF6_EXTRA_CMAKE_MODULES
	select BR2_PACKAGE_KF6_KARCHIVE
	select BR2_PACKAGE_KF6_KBOOKMARKS
	select BR2_PACKAGE_KF6_KCOLORSCHEME
	select BR2_PACKAGE_KF6_KCOMPLETION
	select BR2_PACKAGE_KF6_KCONFIG
	select BR2_PACKAGE_KF6_KCOREADDONS
	select BR2_PACKAGE_KF6_KCRASH
	select BR2_PACKAGE_KF6_KDBUSADDONS
	select BR2_PACKAGE_KF6_KGUIADDONS
	select BR2_PACKAGE_KF6_KI18N
	select BR2_PACKAGE_KF6_KICONTHEMES
	select BR2_PACKAGE_KF6_KITEMVIEWS
	select BR2_PACKAGE_KF6_KJOBWIDGETS
	select BR2_PACKAGE_KF6_KNOTIFICATIONS
	select BR2_PACKAGE_KF6_KSERVICE
	select BR2_PACKAGE_KF6_KWALLET
	select BR2_PACKAGE_KF6_KWIDGETSADDONS
	select BR2_PACKAGE_KF6_KWINDOWSYSTEM
	select BR2_PACKAGE_KF6_SOLID
	select BR2_PACKAGE_LIBXML2
	select BR2_PACKAGE_LIBXSLT
	select BR2_PACKAGE_QT6BASE
	select BR2_PACKAGE_UTIL_LINUX
	help
	  KDE frameworks: kio 6.32.0. GENERATED by scripts/kde-gen.py.
```

## external/package/kf6-kirigami/Config.in
```kconfig
config BR2_PACKAGE_KF6_KIRIGAMI
	bool "kf6-kirigami"
	select BR2_PACKAGE_KF6_EXTRA_CMAKE_MODULES
	select BR2_PACKAGE_QT6BASE
	select BR2_PACKAGE_QT6DECLARATIVE
	select BR2_PACKAGE_QT6SHADERTOOLS
	select BR2_PACKAGE_QT6SVG
	help
	  KDE frameworks: kirigami 6.32.0. GENERATED by scripts/kde-gen.py.
```

## external/package/kf6-kitemmodels/Config.in
```kconfig
config BR2_PACKAGE_KF6_KITEMMODELS
	bool "kf6-kitemmodels"
	select BR2_PACKAGE_KF6_EXTRA_CMAKE_MODULES
	select BR2_PACKAGE_QT6BASE
	select BR2_PACKAGE_QT6DECLARATIVE
	help
	  KDE frameworks: kitemmodels 6.32.0. GENERATED by scripts/kde-gen.py.
```

## external/package/kf6-kitemviews/Config.in
```kconfig
config BR2_PACKAGE_KF6_KITEMVIEWS
	bool "kf6-kitemviews"
	select BR2_PACKAGE_KF6_EXTRA_CMAKE_MODULES
	select BR2_PACKAGE_QT6BASE
	help
	  KDE frameworks: kitemviews 6.32.0. GENERATED by scripts/kde-gen.py.
```

## external/package/kf6-kjobwidgets/Config.in
```kconfig
config BR2_PACKAGE_KF6_KJOBWIDGETS
	bool "kf6-kjobwidgets"
	select BR2_PACKAGE_KF6_EXTRA_CMAKE_MODULES
	select BR2_PACKAGE_KF6_KCOREADDONS
	select BR2_PACKAGE_KF6_KNOTIFICATIONS
	select BR2_PACKAGE_KF6_KWIDGETSADDONS
	select BR2_PACKAGE_QT6BASE
	help
	  KDE frameworks: kjobwidgets 6.32.0. GENERATED by scripts/kde-gen.py.
```

## external/package/kf6-knewstuff/Config.in
```kconfig
config BR2_PACKAGE_KF6_KNEWSTUFF
	bool "kf6-knewstuff"
	select BR2_PACKAGE_KF6_ATTICA
	select BR2_PACKAGE_KF6_EXTRA_CMAKE_MODULES
	select BR2_PACKAGE_KF6_KARCHIVE
	select BR2_PACKAGE_KF6_KCONFIG
	select BR2_PACKAGE_KF6_KCOREADDONS
	select BR2_PACKAGE_KF6_KI18N
	select BR2_PACKAGE_KF6_KIRIGAMI
	select BR2_PACKAGE_KF6_KPACKAGE
	select BR2_PACKAGE_KF6_KWIDGETSADDONS
	select BR2_PACKAGE_KF6_SYNDICATION
	select BR2_PACKAGE_QT6BASE
	select BR2_PACKAGE_QT6DECLARATIVE
	help
	  KDE frameworks: knewstuff 6.32.0. GENERATED by scripts/kde-gen.py.
```

## external/package/kf6-knotifications/Config.in
```kconfig
config BR2_PACKAGE_KF6_KNOTIFICATIONS
	bool "kf6-knotifications"
	select BR2_PACKAGE_KF6_EXTRA_CMAKE_MODULES
	select BR2_PACKAGE_KF6_KCONFIG
	select BR2_PACKAGE_LIBCANBERRA
	select BR2_PACKAGE_QT6BASE
	select BR2_PACKAGE_QT6DECLARATIVE
	help
	  KDE frameworks: knotifications 6.32.0. GENERATED by scripts/kde-gen.py.
```

## external/package/kf6-knotifyconfig/Config.in
```kconfig
config BR2_PACKAGE_KF6_KNOTIFYCONFIG
	bool "kf6-knotifyconfig"
	select BR2_PACKAGE_KF6_EXTRA_CMAKE_MODULES
	select BR2_PACKAGE_KF6_KI18N
	select BR2_PACKAGE_KF6_KIO
	select BR2_PACKAGE_KF6_KNOTIFICATIONS
	select BR2_PACKAGE_KF6_KXMLGUI
	select BR2_PACKAGE_LIBCANBERRA
	select BR2_PACKAGE_QT6BASE
	select BR2_PACKAGE_QT6MULTIMEDIA
	help
	  KDE frameworks: knotifyconfig 6.32.0. GENERATED by scripts/kde-gen.py.
```

## external/package/kf6-kpackage/Config.in
```kconfig
config BR2_PACKAGE_KF6_KPACKAGE
	bool "kf6-kpackage"
	select BR2_PACKAGE_KF6_EXTRA_CMAKE_MODULES
	select BR2_PACKAGE_KF6_KARCHIVE
	select BR2_PACKAGE_KF6_KCOREADDONS
	select BR2_PACKAGE_KF6_KI18N
	select BR2_PACKAGE_QT6BASE
	help
	  KDE frameworks: kpackage 6.32.0. GENERATED by scripts/kde-gen.py.
```

## external/package/kf6-kparts/Config.in
```kconfig
config BR2_PACKAGE_KF6_KPARTS
	bool "kf6-kparts"
	select BR2_PACKAGE_KF6_EXTRA_CMAKE_MODULES
	select BR2_PACKAGE_KF6_KIO
	select BR2_PACKAGE_KF6_KNOTIFICATIONS
	select BR2_PACKAGE_KF6_KXMLGUI
	select BR2_PACKAGE_QT6BASE
	help
	  KDE frameworks: kparts 6.32.0. GENERATED by scripts/kde-gen.py.
```

## external/package/kf6-kpty/Config.in
```kconfig
config BR2_PACKAGE_KF6_KPTY
	bool "kf6-kpty"
	select BR2_PACKAGE_KF6_EXTRA_CMAKE_MODULES
	select BR2_PACKAGE_KF6_KCOREADDONS
	select BR2_PACKAGE_KF6_KI18N
	select BR2_PACKAGE_LIBUTEMPTER
	select BR2_PACKAGE_QT6BASE
	help
	  KDE frameworks: kpty 6.32.0. GENERATED by scripts/kde-gen.py.
```

## external/package/kf6-kquickcharts/Config.in
```kconfig
config BR2_PACKAGE_KF6_KQUICKCHARTS
	bool "kf6-kquickcharts"
	select BR2_PACKAGE_KF6_EXTRA_CMAKE_MODULES
	select BR2_PACKAGE_QT6BASE
	select BR2_PACKAGE_QT6DECLARATIVE
	select BR2_PACKAGE_QT6SHADERTOOLS
	help
	  KDE frameworks: kquickcharts 6.32.0. GENERATED by scripts/kde-gen.py.
```

## external/package/kf6-krunner/Config.in
```kconfig
config BR2_PACKAGE_KF6_KRUNNER
	bool "kf6-krunner"
	select BR2_PACKAGE_KF6_EXTRA_CMAKE_MODULES
	select BR2_PACKAGE_KF6_KCONFIG
	select BR2_PACKAGE_KF6_KCOREADDONS
	select BR2_PACKAGE_KF6_KI18N
	select BR2_PACKAGE_KF6_KITEMMODELS
	select BR2_PACKAGE_KF6_KWINDOWSYSTEM
	select BR2_PACKAGE_KF6_THREADWEAVER
	select BR2_PACKAGE_QT6BASE
	help
	  KDE frameworks: krunner 6.32.0. GENERATED by scripts/kde-gen.py.
```

## external/package/kf6-kservice/Config.in
```kconfig
config BR2_PACKAGE_KF6_KSERVICE
	bool "kf6-kservice"
	select BR2_PACKAGE_KF6_EXTRA_CMAKE_MODULES
	select BR2_PACKAGE_KF6_KCONFIG
	select BR2_PACKAGE_KF6_KCOREADDONS
	select BR2_PACKAGE_KF6_KI18N
	select BR2_PACKAGE_QT6BASE
	help
	  KDE frameworks: kservice 6.32.0. GENERATED by scripts/kde-gen.py.
```

## external/package/kf6-kstatusnotifieritem/Config.in
```kconfig
config BR2_PACKAGE_KF6_KSTATUSNOTIFIERITEM
	bool "kf6-kstatusnotifieritem"
	select BR2_PACKAGE_KF6_EXTRA_CMAKE_MODULES
	select BR2_PACKAGE_KF6_KWINDOWSYSTEM
	select BR2_PACKAGE_QT6BASE
	select BR2_PACKAGE_XLIB_LIBX11
	help
	  KDE frameworks: kstatusnotifieritem 6.32.0. GENERATED by scripts/kde-gen.py.
```

## external/package/kf6-ksvg/Config.in
```kconfig
config BR2_PACKAGE_KF6_KSVG
	bool "kf6-ksvg"
	select BR2_PACKAGE_KF6_EXTRA_CMAKE_MODULES
	select BR2_PACKAGE_KF6_KARCHIVE
	select BR2_PACKAGE_KF6_KCOLORSCHEME
	select BR2_PACKAGE_KF6_KCONFIG
	select BR2_PACKAGE_KF6_KCOREADDONS
	select BR2_PACKAGE_KF6_KGUIADDONS
	select BR2_PACKAGE_KF6_KIRIGAMI
	select BR2_PACKAGE_QT6BASE
	select BR2_PACKAGE_QT6DECLARATIVE
	select BR2_PACKAGE_QT6SVG
	help
	  KDE frameworks: ksvg 6.32.0. GENERATED by scripts/kde-gen.py.
```

## external/package/kf6-ktexteditor/Config.in
```kconfig
config BR2_PACKAGE_KF6_KTEXTEDITOR
	bool "kf6-ktexteditor"
	select BR2_PACKAGE_KF6_BREEZE_ICONS
	select BR2_PACKAGE_KF6_EXTRA_CMAKE_MODULES
	select BR2_PACKAGE_KF6_KARCHIVE
	select BR2_PACKAGE_KF6_KAUTH
	select BR2_PACKAGE_KF6_KCOLORSCHEME
	select BR2_PACKAGE_KF6_KCONFIG
	select BR2_PACKAGE_KF6_KGUIADDONS
	select BR2_PACKAGE_KF6_KI18N
	select BR2_PACKAGE_KF6_KIO
	select BR2_PACKAGE_KF6_KJOBWIDGETS
	select BR2_PACKAGE_KF6_KPARTS
	select BR2_PACKAGE_KF6_KXMLGUI
	select BR2_PACKAGE_KF6_SONNET
	select BR2_PACKAGE_KF6_SYNTAX_HIGHLIGHTING
	select BR2_PACKAGE_QT6BASE
	select BR2_PACKAGE_QT6DECLARATIVE
	help
	  KDE frameworks: ktexteditor 6.32.0. GENERATED by scripts/kde-gen.py.
```

## external/package/kf6-ktextwidgets/Config.in
```kconfig
config BR2_PACKAGE_KF6_KTEXTWIDGETS
	bool "kf6-ktextwidgets"
	select BR2_PACKAGE_KF6_EXTRA_CMAKE_MODULES
	select BR2_PACKAGE_KF6_KCOMPLETION
	select BR2_PACKAGE_KF6_KCONFIG
	select BR2_PACKAGE_KF6_KI18N
	select BR2_PACKAGE_KF6_KWIDGETSADDONS
	select BR2_PACKAGE_KF6_SONNET
	select BR2_PACKAGE_QT6BASE
	help
	  KDE frameworks: ktextwidgets 6.32.0. GENERATED by scripts/kde-gen.py.
```

## external/package/kf6-kunitconversion/Config.in
```kconfig
config BR2_PACKAGE_KF6_KUNITCONVERSION
	bool "kf6-kunitconversion"
	select BR2_PACKAGE_KF6_EXTRA_CMAKE_MODULES
	select BR2_PACKAGE_KF6_KCONFIG
	select BR2_PACKAGE_KF6_KI18N
	select BR2_PACKAGE_QT6BASE
	help
	  KDE frameworks: kunitconversion 6.32.0. GENERATED by scripts/kde-gen.py.
```

## external/package/kf6-kwallet/Config.in
```kconfig
config BR2_PACKAGE_KF6_KWALLET
	bool "kf6-kwallet"
	select BR2_PACKAGE_KDE_QCA
	select BR2_PACKAGE_KF6_EXTRA_CMAKE_MODULES
	select BR2_PACKAGE_KF6_KCOLORSCHEME
	select BR2_PACKAGE_KF6_KCONFIG
	select BR2_PACKAGE_KF6_KCOREADDONS
	select BR2_PACKAGE_KF6_KCRASH
	select BR2_PACKAGE_KF6_KDBUSADDONS
	select BR2_PACKAGE_KF6_KI18N
	select BR2_PACKAGE_KF6_KICONTHEMES
	select BR2_PACKAGE_KF6_KNOTIFICATIONS
	select BR2_PACKAGE_KF6_KWIDGETSADDONS
	select BR2_PACKAGE_KF6_KWINDOWSYSTEM
	select BR2_PACKAGE_LIBGCRYPT
	select BR2_PACKAGE_QT6BASE
	help
	  KDE frameworks: kwallet 6.32.0. GENERATED by scripts/kde-gen.py.
```

## external/package/kf6-kwidgetsaddons/Config.in
```kconfig
config BR2_PACKAGE_KF6_KWIDGETSADDONS
	bool "kf6-kwidgetsaddons"
	select BR2_PACKAGE_KF6_EXTRA_CMAKE_MODULES
	select BR2_PACKAGE_QT6BASE
	help
	  KDE frameworks: kwidgetsaddons 6.32.0. GENERATED by scripts/kde-gen.py.
```

## external/package/kf6-kwindowsystem/Config.in
```kconfig
config BR2_PACKAGE_KF6_KWINDOWSYSTEM
	bool "kf6-kwindowsystem"
	select BR2_PACKAGE_KF6_EXTRA_CMAKE_MODULES
	select BR2_PACKAGE_HOST_QT6TOOLS
	select BR2_PACKAGE_HOST_QT6TOOLS_LINGUIST_TOOLS
	select BR2_PACKAGE_QT6BASE_GUI
	select BR2_PACKAGE_QT6BASE_XCB
	select BR2_PACKAGE_XLIB_LIBX11
	select BR2_PACKAGE_LIBXCB
	select BR2_PACKAGE_XCB_UTIL_KEYSYMS
	select BR2_PACKAGE_XCB_UTIL_WM
	help
	  KWindowSystem (KDE Frameworks 6): access to the window
	  manager and window properties (X11).

	  https://invent.kde.org/frameworks/kwindowsystem
```

## external/package/kf6-kxmlgui/Config.in
```kconfig
config BR2_PACKAGE_KF6_KXMLGUI
	bool "kf6-kxmlgui"
	select BR2_PACKAGE_KF6_EXTRA_CMAKE_MODULES
	select BR2_PACKAGE_KF6_KCONFIG
	select BR2_PACKAGE_KF6_KCONFIGWIDGETS
	select BR2_PACKAGE_KF6_KGLOBALACCEL
	select BR2_PACKAGE_KF6_KI18N
	select BR2_PACKAGE_KF6_KICONTHEMES
	select BR2_PACKAGE_KF6_KITEMVIEWS
	select BR2_PACKAGE_KF6_KTEXTWIDGETS
	select BR2_PACKAGE_KF6_KWIDGETSADDONS
	select BR2_PACKAGE_QT6BASE
	help
	  KDE frameworks: kxmlgui 6.32.0. GENERATED by scripts/kde-gen.py.
```

## external/package/kf6-modemmanager-qt/Config.in
```kconfig
config BR2_PACKAGE_KF6_MODEMMANAGER_QT
	bool "kf6-modemmanager-qt"
	select BR2_PACKAGE_KF6_EXTRA_CMAKE_MODULES
	select BR2_PACKAGE_MODEM_MANAGER
	select BR2_PACKAGE_QT6BASE
	help
	  KDE frameworks: modemmanager-qt 6.32.0. GENERATED by scripts/kde-gen.py.
```
