## external/package/kf6-breeze-icons/Config.in
```kconfig
config BR2_PACKAGE_KF6_BREEZE_ICONS
	bool "kf6-breeze-icons"
	select BR2_PACKAGE_KF6_EXTRA_CMAKE_MODULES
	select BR2_PACKAGE_QT6BASE
	help
	  KDE frameworks: breeze-icons 6.32.0. GENERATED by scripts/kde-gen.py.
```

## external/package/kf6-extra-cmake-modules/Config.in
```kconfig
config BR2_PACKAGE_KF6_EXTRA_CMAKE_MODULES
	bool "kf6-extra-cmake-modules"
	select BR2_PACKAGE_FFMPEG
	select BR2_PACKAGE_MESA3D
	select BR2_PACKAGE_QT6BASE
	select BR2_PACKAGE_QT6DECLARATIVE
	help
	  KDE frameworks: extra-cmake-modules 6.32.0. GENERATED by scripts/kde-gen.py.
```

## external/package/kf6-frameworkintegration/Config.in
```kconfig
config BR2_PACKAGE_KF6_FRAMEWORKINTEGRATION
	bool "kf6-frameworkintegration"
	select BR2_PACKAGE_KDE_APPSTREAM
	select BR2_PACKAGE_KF6_EXTRA_CMAKE_MODULES
	select BR2_PACKAGE_KF6_KCOLORSCHEME
	select BR2_PACKAGE_KF6_KCONFIG
	select BR2_PACKAGE_KF6_KCONFIGWIDGETS
	select BR2_PACKAGE_KF6_KGUIADDONS
	select BR2_PACKAGE_KF6_KI18N
	select BR2_PACKAGE_KF6_KICONTHEMES
	select BR2_PACKAGE_KF6_KIO
	select BR2_PACKAGE_KF6_KITEMVIEWS
	select BR2_PACKAGE_KF6_KNEWSTUFF
	select BR2_PACKAGE_KF6_KNOTIFICATIONS
	select BR2_PACKAGE_KF6_KPACKAGE
	select BR2_PACKAGE_KF6_KWIDGETSADDONS
	select BR2_PACKAGE_QT6BASE
	help
	  KDE frameworks: frameworkintegration 6.32.0. GENERATED by scripts/kde-gen.py.
```

## external/package/kf6-karchive/Config.in
```kconfig
config BR2_PACKAGE_KF6_KARCHIVE
	bool "kf6-karchive"
	select BR2_PACKAGE_BZIP2
	select BR2_PACKAGE_KF6_EXTRA_CMAKE_MODULES
	select BR2_PACKAGE_OPENSSL
	select BR2_PACKAGE_QT6BASE
	select BR2_PACKAGE_XZ
	select BR2_PACKAGE_ZLIB
	help
	  KDE frameworks: karchive 6.32.0. GENERATED by scripts/kde-gen.py.
```

## external/package/kf6-kauth/Config.in
```kconfig
config BR2_PACKAGE_KF6_KAUTH
	bool "kf6-kauth"
	select BR2_PACKAGE_KF6_EXTRA_CMAKE_MODULES
	select BR2_PACKAGE_KF6_KCOREADDONS
	select BR2_PACKAGE_KF6_KWINDOWSYSTEM
	select BR2_PACKAGE_POLKIT_QT6
	select BR2_PACKAGE_QT6BASE
	help
	  KDE frameworks: kauth 6.32.0. GENERATED by scripts/kde-gen.py.
```

## external/package/kf6-kbookmarks/Config.in
```kconfig
config BR2_PACKAGE_KF6_KBOOKMARKS
	bool "kf6-kbookmarks"
	select BR2_PACKAGE_KF6_EXTRA_CMAKE_MODULES
	select BR2_PACKAGE_KF6_KCONFIG
	select BR2_PACKAGE_KF6_KCOREADDONS
	select BR2_PACKAGE_KF6_KWIDGETSADDONS
	select BR2_PACKAGE_QT6BASE
	help
	  KDE frameworks: kbookmarks 6.32.0. GENERATED by scripts/kde-gen.py.
```

## external/package/kf6-kcmutils/Config.in
```kconfig
config BR2_PACKAGE_KF6_KCMUTILS
	bool "kf6-kcmutils"
	select BR2_PACKAGE_KF6_EXTRA_CMAKE_MODULES
	select BR2_PACKAGE_KF6_KCOREADDONS
	select BR2_PACKAGE_KF6_KI18N
	select BR2_PACKAGE_KF6_KIO
	select BR2_PACKAGE_KF6_KIRIGAMI
	select BR2_PACKAGE_KF6_KITEMVIEWS
	select BR2_PACKAGE_KF6_KXMLGUI
	select BR2_PACKAGE_QT6BASE
	select BR2_PACKAGE_QT6DECLARATIVE
	help
	  KDE frameworks: kcmutils 6.32.0. GENERATED by scripts/kde-gen.py.
```

## external/package/kf6-kcodecs/Config.in
```kconfig
config BR2_PACKAGE_KF6_KCODECS
	bool "kf6-kcodecs"
	select BR2_PACKAGE_KF6_EXTRA_CMAKE_MODULES
	select BR2_PACKAGE_QT6BASE
	help
	  KDE frameworks: kcodecs 6.32.0. GENERATED by scripts/kde-gen.py.
```

## external/package/kf6-kcolorscheme/Config.in
```kconfig
config BR2_PACKAGE_KF6_KCOLORSCHEME
	bool "kf6-kcolorscheme"
	select BR2_PACKAGE_KF6_EXTRA_CMAKE_MODULES
	select BR2_PACKAGE_KF6_KCONFIG
	select BR2_PACKAGE_KF6_KGUIADDONS
	select BR2_PACKAGE_KF6_KI18N
	select BR2_PACKAGE_QT6BASE
	help
	  KDE frameworks: kcolorscheme 6.32.0. GENERATED by scripts/kde-gen.py.
```

## external/package/kf6-kcompletion/Config.in
```kconfig
config BR2_PACKAGE_KF6_KCOMPLETION
	bool "kf6-kcompletion"
	select BR2_PACKAGE_KF6_EXTRA_CMAKE_MODULES
	select BR2_PACKAGE_KF6_KCODECS
	select BR2_PACKAGE_KF6_KCONFIG
	select BR2_PACKAGE_KF6_KWIDGETSADDONS
	select BR2_PACKAGE_QT6BASE
	help
	  KDE frameworks: kcompletion 6.32.0. GENERATED by scripts/kde-gen.py.
```

## external/package/kf6-kconfig/Config.in
```kconfig
config BR2_PACKAGE_KF6_KCONFIG
	bool "kf6-kconfig"
	select BR2_PACKAGE_KF6_EXTRA_CMAKE_MODULES
	select BR2_PACKAGE_QT6BASE
	select BR2_PACKAGE_QT6DECLARATIVE
	help
	  KDE frameworks: kconfig 6.32.0. GENERATED by scripts/kde-gen.py.
```

## external/package/kf6-kconfigwidgets/Config.in
```kconfig
config BR2_PACKAGE_KF6_KCONFIGWIDGETS
	bool "kf6-kconfigwidgets"
	select BR2_PACKAGE_KF6_EXTRA_CMAKE_MODULES
	select BR2_PACKAGE_KF6_KCODECS
	select BR2_PACKAGE_KF6_KCOLORSCHEME
	select BR2_PACKAGE_KF6_KCONFIG
	select BR2_PACKAGE_KF6_KCOREADDONS
	select BR2_PACKAGE_KF6_KGUIADDONS
	select BR2_PACKAGE_KF6_KI18N
	select BR2_PACKAGE_KF6_KWIDGETSADDONS
	select BR2_PACKAGE_QT6BASE
	help
	  KDE frameworks: kconfigwidgets 6.32.0. GENERATED by scripts/kde-gen.py.
```

## external/package/kf6-kcoreaddons/Config.in
```kconfig
config BR2_PACKAGE_KF6_KCOREADDONS
	bool "kf6-kcoreaddons"
	select BR2_PACKAGE_EUDEV
	select BR2_PACKAGE_KF6_EXTRA_CMAKE_MODULES
	select BR2_PACKAGE_QT6BASE
	select BR2_PACKAGE_QT6DECLARATIVE
	select BR2_PACKAGE_SHARED_MIME_INFO
	select BR2_PACKAGE_UTIL_LINUX
	help
	  KDE frameworks: kcoreaddons 6.32.0. GENERATED by scripts/kde-gen.py.
```

## external/package/kf6-kcrash/Config.in
```kconfig
config BR2_PACKAGE_KF6_KCRASH
	bool "kf6-kcrash"
	select BR2_PACKAGE_KF6_EXTRA_CMAKE_MODULES
	select BR2_PACKAGE_KF6_KCOREADDONS
	select BR2_PACKAGE_QT6BASE
	select BR2_PACKAGE_XLIB_LIBX11
	help
	  KDE frameworks: kcrash 6.32.0. GENERATED by scripts/kde-gen.py.
```

## external/package/kf6-kdbusaddons/Config.in
```kconfig
config BR2_PACKAGE_KF6_KDBUSADDONS
	bool "kf6-kdbusaddons"
	select BR2_PACKAGE_KF6_EXTRA_CMAKE_MODULES
	select BR2_PACKAGE_QT6BASE
	help
	  KDE frameworks: kdbusaddons 6.32.0. GENERATED by scripts/kde-gen.py.
```

## external/package/kf6-kdeclarative/Config.in
```kconfig
config BR2_PACKAGE_KF6_KDECLARATIVE
	bool "kf6-kdeclarative"
	select BR2_PACKAGE_KF6_EXTRA_CMAKE_MODULES
	select BR2_PACKAGE_KF6_KCONFIG
	select BR2_PACKAGE_KF6_KGLOBALACCEL
	select BR2_PACKAGE_KF6_KGUIADDONS
	select BR2_PACKAGE_KF6_KI18N
	select BR2_PACKAGE_KF6_KWIDGETSADDONS
	select BR2_PACKAGE_QT6BASE
	select BR2_PACKAGE_QT6DECLARATIVE
	select BR2_PACKAGE_QT6SHADERTOOLS
	help
	  KDE frameworks: kdeclarative 6.32.0. GENERATED by scripts/kde-gen.py.
```

## external/package/kf6-kded/Config.in
```kconfig
config BR2_PACKAGE_KF6_KDED
	bool "kf6-kded"
	select BR2_PACKAGE_KF6_EXTRA_CMAKE_MODULES
	select BR2_PACKAGE_KF6_KCOREADDONS
	select BR2_PACKAGE_KF6_KCRASH
	select BR2_PACKAGE_KF6_KDBUSADDONS
	select BR2_PACKAGE_KF6_KI18N
	select BR2_PACKAGE_KF6_KSERVICE
	select BR2_PACKAGE_QT6BASE
	help
	  KDE frameworks: kded 6.32.0. GENERATED by scripts/kde-gen.py.
```

## external/package/kf6-kdesu/Config.in
```kconfig
config BR2_PACKAGE_KF6_KDESU
	bool "kf6-kdesu"
	select BR2_PACKAGE_KF6_EXTRA_CMAKE_MODULES
	select BR2_PACKAGE_KF6_KCONFIG
	select BR2_PACKAGE_KF6_KCOREADDONS
	select BR2_PACKAGE_KF6_KPTY
	select BR2_PACKAGE_QT6BASE
	select BR2_PACKAGE_XLIB_LIBX11
	help
	  KDE frameworks: kdesu 6.32.0. GENERATED by scripts/kde-gen.py.
```

## external/package/kf6-kdnssd/Config.in
```kconfig
config BR2_PACKAGE_KF6_KDNSSD
	bool "kf6-kdnssd"
	select BR2_PACKAGE_AVAHI
	select BR2_PACKAGE_KF6_EXTRA_CMAKE_MODULES
	select BR2_PACKAGE_QT6BASE
	help
	  KDE frameworks: kdnssd 6.32.0. GENERATED by scripts/kde-gen.py.
```

## external/package/kf6-kfilemetadata/Config.in
```kconfig
config BR2_PACKAGE_KF6_KFILEMETADATA
	bool "kf6-kfilemetadata"
	select BR2_PACKAGE_EXIV2
	select BR2_PACKAGE_FFMPEG
	select BR2_PACKAGE_KF6_EXTRA_CMAKE_MODULES
	select BR2_PACKAGE_KF6_KARCHIVE
	select BR2_PACKAGE_KF6_KCODECS
	select BR2_PACKAGE_KF6_KCOREADDONS
	select BR2_PACKAGE_KF6_KI18N
	select BR2_PACKAGE_LIBXML2
	select BR2_PACKAGE_POPPLER
	select BR2_PACKAGE_QT6BASE
	select BR2_PACKAGE_TAGLIB
	help
	  KDE frameworks: kfilemetadata 6.32.0. GENERATED by scripts/kde-gen.py.
```

## external/package/kf6-kglobalaccel/Config.in
```kconfig
config BR2_PACKAGE_KF6_KGLOBALACCEL
	bool "kf6-kglobalaccel"
	select BR2_PACKAGE_KF6_EXTRA_CMAKE_MODULES
	select BR2_PACKAGE_QT6BASE
	help
	  KDE frameworks: kglobalaccel 6.32.0. GENERATED by scripts/kde-gen.py.
```

## external/package/kf6-kguiaddons/Config.in
```kconfig
config BR2_PACKAGE_KF6_KGUIADDONS
	bool "kf6-kguiaddons"
	select BR2_PACKAGE_KDE_PLASMA_WAYLAND_PROTOCOLS
	select BR2_PACKAGE_KF6_EXTRA_CMAKE_MODULES
	select BR2_PACKAGE_LIBXCB
	select BR2_PACKAGE_QT6BASE
	select BR2_PACKAGE_QT6WAYLAND
	select BR2_PACKAGE_WAYLAND
	select BR2_PACKAGE_WAYLAND_PROTOCOLS
	select BR2_PACKAGE_XCB_UTIL_CURSOR
	select BR2_PACKAGE_XCB_UTIL_IMAGE
	select BR2_PACKAGE_XCB_UTIL_KEYSYMS
	select BR2_PACKAGE_XCB_UTIL_WM
	select BR2_PACKAGE_XLIB_LIBX11
	help
	  KDE frameworks: kguiaddons 6.32.0. GENERATED by scripts/kde-gen.py.
```

## external/package/kf6-ki18n/Config.in
```kconfig
config BR2_PACKAGE_KF6_KI18N
	bool "kf6-ki18n"
	select BR2_PACKAGE_KF6_EXTRA_CMAKE_MODULES
	select BR2_PACKAGE_QT6BASE
	select BR2_PACKAGE_QT6DECLARATIVE
	help
	  KDE frameworks: ki18n 6.32.0. GENERATED by scripts/kde-gen.py.
```

## external/package/kf6-kiconthemes/Config.in
```kconfig
config BR2_PACKAGE_KF6_KICONTHEMES
	bool "kf6-kiconthemes"
	select BR2_PACKAGE_KF6_BREEZE_ICONS
	select BR2_PACKAGE_KF6_EXTRA_CMAKE_MODULES
	select BR2_PACKAGE_KF6_KARCHIVE
	select BR2_PACKAGE_KF6_KCOLORSCHEME
	select BR2_PACKAGE_KF6_KCONFIG
	select BR2_PACKAGE_KF6_KI18N
	select BR2_PACKAGE_KF6_KWIDGETSADDONS
	select BR2_PACKAGE_QT6BASE
	select BR2_PACKAGE_QT6DECLARATIVE
	select BR2_PACKAGE_QT6SVG
	help
	  KDE frameworks: kiconthemes 6.32.0. GENERATED by scripts/kde-gen.py.
```

## external/package/kf6-kidletime/Config.in
```kconfig
config BR2_PACKAGE_KF6_KIDLETIME
	bool "kf6-kidletime"
	select BR2_PACKAGE_KF6_EXTRA_CMAKE_MODULES
	select BR2_PACKAGE_LIBXCB
	select BR2_PACKAGE_QT6BASE
	select BR2_PACKAGE_XCB_UTIL_CURSOR
	select BR2_PACKAGE_XCB_UTIL_IMAGE
	select BR2_PACKAGE_XCB_UTIL_KEYSYMS
	select BR2_PACKAGE_XCB_UTIL_WM
	select BR2_PACKAGE_XLIB_LIBX11
	help
	  KDE frameworks: kidletime 6.32.0. GENERATED by scripts/kde-gen.py.
```
